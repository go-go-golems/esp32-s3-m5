## 0048-cardputer-js-web/sdkconfig.defaults
```kconfig
# Flash size: Cardputer is commonly 8MB.
CONFIG_ESPTOOLPY_FLASHSIZE_8MB=y
CONFIG_ESPTOOLPY_FLASHSIZE="8MB"

# Partition table: project-local partitions.csv (factory 4M + storage 1M).
CONFIG_PARTITION_TABLE_CUSTOM=y
CONFIG_PARTITION_TABLE_CUSTOM_FILENAME="partitions.csv"
CONFIG_PARTITION_TABLE_FILENAME="partitions.csv"

# CPU frequency: Cardputer demos usually run at 240MHz.
CONFIG_ESP_DEFAULT_CPU_FREQ_MHZ_240=y
CONFIG_ESP_DEFAULT_CPU_FREQ_MHZ=240

# Main task stack: C++ + QuickJS can be stack-hungry.
CONFIG_ESP_MAIN_TASK_STACK_SIZE=8000

# Console defaults (repo guidance prefers USB Serial/JTAG for interactive work).
CONFIG_ESP_CONSOLE_USB_SERIAL_JTAG=y
CONFIG_ESP_CONSOLE_UART_DEFAULT=n
CONFIG_ESP_CONSOLE_UART_CUSTOM=n
CONFIG_ESP_CONSOLE_USB_CDC=n

# Enable WebSocket support (Phase 2 uses it; harmless in Phase 1).
CONFIG_HTTPD_WS_SUPPORT=y
```

## 0049-xiao-esp32c6-mled-node/main/Kconfig.projbuild
```kconfig
menu "0049: ESP32-C6 MLED Node"

config MLEDNODE_WIFI_MAX_RETRY
    int "Wi-Fi max retries"
    range 0 100
    default 10
    help
        Maximum number of retries after a STA disconnect when autoconnect is enabled.

config MLEDNODE_WIFI_AUTOCONNECT_ON_BOOT
    bool "Autoconnect on boot when credentials exist"
    default y
    help
        If enabled, and runtime credentials are present at STA start (e.g. loaded from NVS),
        the device will attempt to connect automatically.

config MLEDNODE_WS281X_GPIO_NUM
    int "WS281x data GPIO (XIAO D1 default)"
    range 0 48
    default 1
    help
        Data output GPIO used to drive the strip.

        For Seeed XIAO ESP32C6, D1 maps to GPIO1.

config MLEDNODE_WS281X_LED_COUNT
    int "WS281x LED count"
    range 1 1024
    default 50
    help
        Number of addressable LEDs in the chain.

config MLEDNODE_WS281X_FRAME_MS
    int "WS281x animation frame time (ms)"
    range 1 1000
    default 16
    help
        Delay between frames. Lower is smoother but uses more CPU.

config MLEDNODE_WS281X_T0H_NS
    int "WS281x T0H (ns)"
    range 50 2000
    default 350
    help
        High time for a logical 0 bit.

config MLEDNODE_WS281X_T0L_NS
    int "WS281x T0L (ns)"
    range 50 2000
    default 800
    help
        Low time for a logical 0 bit.

config MLEDNODE_WS281X_T1H_NS
    int "WS281x T1H (ns)"
    range 50 2000
    default 700
    help
        High time for a logical 1 bit.

config MLEDNODE_WS281X_T1L_NS
    int "WS281x T1L (ns)"
    range 50 2000
    default 600
    help
        Low time for a logical 1 bit.

config MLEDNODE_WS281X_RESET_US
    int "WS281x reset time (us)"
    range 10 500
    default 80
    help
        Low reset time after sending a frame.

endmenu
```

## 0065-xiao-esp32c6-gpio-web-server/main/Kconfig.projbuild
```kconfig
menu "MO-065: GPIO web server"

config MO065_GPIO_D2_GPIO_NUM
    int "D2 GPIO number"
    default 2
    help
        GPIO number to treat as “D2”.

config MO065_GPIO_D3_GPIO_NUM
    int "D3 GPIO number"
    default 21
    help
        GPIO number to treat as “D3”.

config MO065_GPIO_D2_ACTIVE_LOW
    bool "D2 active-low output"
    default y
    help
        If enabled, logical “on” drives the GPIO low.

config MO065_GPIO_D3_ACTIVE_LOW
    bool "D3 active-low output"
    default y
    help
        If enabled, logical “on” drives the GPIO low.

endmenu

menu "MO-065: OLED status display (SSD1306-class, I2C)"

config MO065_OLED_ENABLE
    bool "Enable OLED status display"
    default n
    help
        If enabled, the firmware will initialize an SSD1306-class 128x64 OLED over I2C
        and render Wi-Fi status + IP address.

config MO065_OLED_I2C_SDA_GPIO_NUM
    int "I2C SDA GPIO number"
    depends on MO065_OLED_ENABLE
    default 22
    help
        SDA GPIO for the OLED I2C bus.
        For Seeed Studio XIAO ESP32C6: SDA is GPIO22 (board pin4).

config MO065_OLED_I2C_SCL_GPIO_NUM
    int "I2C SCL GPIO number"
    depends on MO065_OLED_ENABLE
    default 23
    help
        SCL GPIO for the OLED I2C bus.
        For Seeed Studio XIAO ESP32C6: SCL is GPIO23 (board pin5).

config MO065_OLED_I2C_ADDR
    hex "OLED I2C address (7-bit)"
    depends on MO065_OLED_ENABLE
    default 0x3C
    help
        The OLED's 7-bit I2C address. Common values are 0x3C and 0x3D.

config MO065_OLED_I2C_SPEED_HZ
    int "I2C clock speed (Hz)"
    depends on MO065_OLED_ENABLE
    default 400000
    range 10000 1000000
    help
        I2C bus speed. If bring-up is flaky or wires are long, try 100000 first.

config MO065_OLED_I2C_INTERNAL_PULLUPS
    bool "Enable internal pull-ups on SDA/SCL"
    depends on MO065_OLED_ENABLE
    default y
    help
        Enable ESP32 internal pull-ups for the I2C pins.
        Note: these are weak; prefer external pull-ups if possible.

config MO065_OLED_SCAN_ON_BOOT
    bool "Probe I2C addresses on boot (log ACKs)"
    depends on MO065_OLED_ENABLE
    default n
    help
        If enabled, probes all 7-bit I2C addresses (0x08..0x77) once on boot and
        logs any that ACK. Useful for discovering the OLED address during bring-up.

config MO065_OLED_REFRESH_MS
    int "Refresh interval (ms)"
    depends on MO065_OLED_ENABLE
    default 500
    range 100 5000
    help
        OLED update task interval. The task only redraws when Wi-Fi state/IP changes,
        but it wakes up at this cadence to poll status.

endmenu
```

## 0066-cardputer-adv-ledchain-gfx-sim/main/Kconfig.projbuild
```kconfig
menu "0066: Cardputer LED chain GFX sim"

config TUTORIAL_0066_LED_COUNT
    int "LED count (virtual)"
    range 1 300
    default 50
    help
        Number of LEDs to simulate and draw on-screen.

config TUTORIAL_0066_FRAME_MS
    int "Frame time (ms)"
    range 1 1000
    default 16
    help
        Delay between frames. Lower is smoother but uses more CPU.

config TUTORIAL_0066_CANVAS_USE_PSRAM
    bool "Allocate M5Canvas sprite in PSRAM (disable for DMA)"
    default n
    help
        PSRAM sprites typically disable DMA paths; keep disabled for best performance.

config TUTORIAL_0066_PRESENT_WAIT_DMA
    bool "Wait for DMA after present"
    default y
    help
        Conservative display safety: wait for any DMA transfer to finish after pushSprite.

config TUTORIAL_0066_JS_MEM_BYTES
    int "MicroQuickJS arena bytes"
    range 16384 524288
    default 65536
    help
        JS heap arena size for MicroQuickJS (mquickjs). This is a fixed-size arena allocated
        for the VM owner task.

config TUTORIAL_0066_JS_MAX_BODY
    int "Max /api/js/eval body bytes"
    range 256 65536
    default 4096
    help
        Maximum HTTP request body size accepted by /api/js/eval (raw JS code).

config TUTORIAL_0066_KB_SCAN_PERIOD_MS
    int "Keyboard poll fallback period (ms)"
    range 5 100
    default 15
    help
        Fallback poll period for the Cardputer-ADV keyboard (TCA8418). The primary mechanism is the
        keyboard INT line; polling is used as a safety net if interrupts are missed.

config TUTORIAL_0066_G3_GPIO
    int "Board label G3: ESP32-S3 GPIO number"
    range 0 48
    default 3
    help
        GPIO number to use for the board label "G3".

        Evidence-based default: in tutorial 0047, the Cardputer-ADV Grove UART defaults
        are labeled "G1" and "G2" and map to GPIO1 and GPIO2 respectively. We therefore
        default G3->GPIO3.

config TUTORIAL_0066_G4_GPIO
    int "Board label G4: ESP32-S3 GPIO number"
    range 0 48
    default 4
    help
        GPIO number to use for the board label "G4". See G3 notes; default G4->GPIO4.

endmenu
```

## 0066-cardputer-adv-ledchain-gfx-sim/sdkconfig.defaults
```kconfig
# Tutorial 0066 defaults (ESP-IDF 5.4.x)
#
# Cardputer-ADV-style defaults for a console-driven M5GFX app.
#

# Flash size: Cardputer/ADV is commonly 8MB.
CONFIG_ESPTOOLPY_FLASHSIZE_8MB=y
CONFIG_ESPTOOLPY_FLASHSIZE="8MB"

# Partition table: project-local partitions.csv (factory 4M + storage 1M).
CONFIG_PARTITION_TABLE_CUSTOM=y
CONFIG_PARTITION_TABLE_CUSTOM_FILENAME="partitions.csv"
CONFIG_PARTITION_TABLE_FILENAME="partitions.csv"

# CPU frequency: common default for Cardputer demos.
CONFIG_ESP_DEFAULT_CPU_FREQ_MHZ_240=y
CONFIG_ESP_DEFAULT_CPU_FREQ_MHZ=240

# Main task stack: C++ + M5GFX can be stack-hungry.
CONFIG_ESP_MAIN_TASK_STACK_SIZE=8000

# Prefer USB Serial/JTAG for the interactive console on Cardputer/ADV.
CONFIG_ESP_CONSOLE_USB_SERIAL_JTAG=y
CONFIG_ESP_CONSOLE_UART_DEFAULT=n
CONFIG_ESP_CONSOLE_UART_CUSTOM=n
CONFIG_ESP_CONSOLE_USB_CDC=n

# Enable esp_http_server WebSocket support for the on-device JS Web IDE.
CONFIG_HTTPD_WS_SUPPORT=y

# Tutorial defaults:
CONFIG_TUTORIAL_0066_LED_COUNT=50
CONFIG_TUTORIAL_0066_FRAME_MS=16
CONFIG_TUTORIAL_0066_CANVAS_USE_PSRAM=n
CONFIG_TUTORIAL_0066_PRESENT_WAIT_DMA=y
```

## components/echo_gif/Kconfig
```kconfig
menu "echo_gif: GIF storage + registry + playback"

config ECHO_GIF_MIN_FRAME_DELAY_MS
    int "Minimum frame delay (ms)"
    range 0 1000
    default 10
    help
        Some GIFs request a 0ms delay. This sets a floor so the playback loop yields.

config ECHO_GIF_MAX_COUNT
    int "Maximum number of GIF assets to list"
    range 1 256
    default 32

config ECHO_GIF_MAX_PATH_LEN
    int "Maximum GIF path length"
    range 32 256
    default 96

config ECHO_GIF_SWAP_BYTES
    bool "Byte-swap RGB565 pixels before writing into M5Canvas"
    default y
    help
        Some pipelines produce RGB565 in MSB-first byte order. Toggle this if colors look wrong.

config ECHO_GIF_SCALE_TO_FULL_SCREEN
    bool "Scale GIF canvas to fill screen (nearest-neighbor integer scaling)"
    default y

config ECHO_GIF_STORAGE_MOUNT_PATH
    string "FATFS mount point"
    default "/storage"

config ECHO_GIF_STORAGE_PARTITION_LABEL
    string "Flash partition label containing FATFS image"
    default "storage"

config ECHO_GIF_STORAGE_GIF_DIR
    string "Preferred directory containing GIFs"
    default "/storage/gifs"

config ECHO_GIF_STORAGE_GIF_DIR_FALLBACK
    string "Fallback GIF directory"
    default "/storage"

endmenu
```

## components/mled_node/Kconfig
```kconfig
menu "mled_node: MLED/1 UDP multicast node"

config MLED_NODE_NAME
    string "Node name (PONG name[16])"
    default "c6-node"
    help
        Name reported in PONG payload (truncated to 16 bytes).

config MLED_NODE_TIME_REQ_ENABLE
    bool "Enable TIME_REQ refinement (send after BEACON)"
    default y
    help
        If enabled, the node sends TIME_REQ unicast messages to the controller address learned from BEACON.
        This refines show-time offset beyond the coarse BEACON sync.

config MLED_NODE_TIME_REQ_MIN_INTERVAL_MS
    int "Minimum TIME_REQ interval (ms)"
    range 0 60000
    default 500
    help
        Minimum time between successive TIME_REQ messages (rate-limit).

endmenu
```

## components/wifi_console/Kconfig
```kconfig
menu "Wi-Fi console"

config WIFI_CONSOLE_MAX_SCAN_RESULTS
    int "Max scan results cached"
    range 1 200
    default 20
    help
        Maximum number of scan results cached for `wifi join <index> ...`.

endmenu
```

## components/wifi_mgr/Kconfig
```kconfig
menu "wifi_mgr: Wi-Fi STA manager"

config WIFI_MGR_MAX_RETRY
    int "Wi-Fi max retries"
    range 0 100
    default 10
    help
        Maximum number of retries after a STA disconnect when autoconnect is enabled.

config WIFI_MGR_AUTOCONNECT_ON_BOOT
    bool "Autoconnect on boot when credentials exist"
    default y
    help
        If enabled, and runtime credentials are present at STA start (e.g. loaded from NVS),
        the device will attempt to connect automatically.

endmenu
```

## imports/esp32-mqjs-repl/mqjs-repl/main/Kconfig.projbuild
```kconfig
menu "mqjs-repl"

choice MQJS_REPL_CONSOLE
    prompt "REPL console transport"
    default MQJS_REPL_CONSOLE_UART0
    help
        Select which transport the REPL uses for interactive input/output.

config MQJS_REPL_CONSOLE_UART0
    bool "UART0 (QEMU-friendly)"
    help
        Use the ESP-IDF UART driver on UART0 for REPL I/O.

config MQJS_REPL_CONSOLE_USB_SERIAL_JTAG
    bool "USB Serial/JTAG (Cardputer)"
    help
        Use the ESP32-S3 USB Serial/JTAG peripheral for REPL I/O (appears as /dev/ttyACM*).

endchoice

config MQJS_STDLIB_ESP32_GENERATED
    bool
    default y

endmenu
```

## thirdparty/esp-zigbee-sdk/examples/esp_zigbee_ncp/sdkconfig.defaults
```kconfig
# Keep UART pins quiet (NCP bus uses GPIO23/24): use USB-Serial/JTAG console
CONFIG_ESP_CONSOLE_USB_SERIAL_JTAG=y
# CONFIG_ESP_CONSOLE_UART is not set

# Reduce bootloader log verbosity (avoid UART0 noise)
CONFIG_BOOTLOADER_LOG_LEVEL_NONE=y
CONFIG_BOOTLOADER_LOG_LEVEL=0

# Increase main task stack size
CONFIG_ESP_MAIN_TASK_STACK_SIZE=7168

# Enable filesystem
CONFIG_PARTITION_TABLE_CUSTOM=y
CONFIG_PARTITION_TABLE_CUSTOM_FILENAME="partitions.csv"
CONFIG_PARTITION_TABLE_FILENAME="partitions.csv"

# Enable FreeRTOS stats formatting functions, needed for 'tasks' command
CONFIG_FREERTOS_USE_TRACE_FACILITY=y
CONFIG_FREERTOS_USE_STATS_FORMATTING_FUNCTIONS=y

#
# Zboss
#
CONFIG_ZB_ENABLED=y
CONFIG_ZB_ZCZR=y
# CONFIG_ZB_ZED is not set
# end of Zboss
# end of Component config

# Unit Gateway H2 (ESP32-H2) pin config per M5Stack `zigbee_ncp` guide:
# Component config -> Zigbee Network Co-processor
#   - UART RX Pin: 23
#   - UART TX Pin: 24
CONFIG_NCP_BUS_UART_RX_PIN=23
CONFIG_NCP_BUS_UART_TX_PIN=24
```

## ttmp/2026/01/04/002-ZIGBEE-NCP-UART-LINK--bugreport-cores3-unit-gateway-h2-ncp-uart-link/scripts/uart_smoke/cores3_uart_smoke/sdkconfig.defaults
```kconfig
# Prefer USB-Serial/JTAG for console (avoid any confusion about UART0 console pins).
CONFIG_ESP_CONSOLE_USB_SERIAL_JTAG=y
# CONFIG_ESP_CONSOLE_UART is not set

CONFIG_LOG_DEFAULT_LEVEL_INFO=y
```

## ttmp/2026/01/04/002-ZIGBEE-NCP-UART-LINK--bugreport-cores3-unit-gateway-h2-ncp-uart-link/scripts/uart_smoke/h2_uart_smoke/sdkconfig.defaults
```kconfig
# Use USB-Serial/JTAG for console so bus UART pins stay dedicated to the smoke test.
CONFIG_ESP_CONSOLE_USB_SERIAL_JTAG=y
# CONFIG_ESP_CONSOLE_UART is not set

CONFIG_LOG_DEFAULT_LEVEL_INFO=y
```
