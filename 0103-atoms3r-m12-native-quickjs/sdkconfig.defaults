## 0103-m5dial-ppa-dial/sdkconfig.defaults
```kconfig
# 0103 m5dial-ppa-dial defaults (ESP-IDF 5.4.1)

CONFIG_ESPTOOLPY_FLASHSIZE_8MB=y
CONFIG_ESPTOOLPY_FLASHSIZE="8MB"

CONFIG_PARTITION_TABLE_CUSTOM=y
CONFIG_PARTITION_TABLE_CUSTOM_FILENAME="partitions.csv"
CONFIG_PARTITION_TABLE_FILENAME="partitions.csv"

CONFIG_ESP_DEFAULT_CPU_FREQ_MHZ_240=y
CONFIG_ESP_DEFAULT_CPU_FREQ_MHZ=240

CONFIG_ESP_MAIN_TASK_STACK_SIZE=8192

CONFIG_COMPILER_CXX_EXCEPTIONS=n

CONFIG_LOG_DEFAULT_LEVEL_INFO=y

CONFIG_LV_MEM_SIZE_KILOBYTES=64
CONFIG_LV_FONT_MONTSERRAT_14=y
CONFIG_LV_FONT_MONTSERRAT_18=y
CONFIG_LV_FONT_MONTSERRAT_20=y
CONFIG_LV_FONT_MONTSERRAT_28=y

CONFIG_LWIP_LOCAL_HOSTNAME="ppadial"
```

## 0108-papers3-m5gfx-runtime-trace/main/Kconfig.projbuild
```kconfig
menu "PaperS3 M5GFX runtime trace"

config PAPERS3_M5GFX_RUNTIME_TRACE
    bool "Enable fixed-ring M5GFX EPD runtime tracing"
    default n
    help
        Compile minimally perturbing EPD trace hooks into M5GFX and retain
        fixed-size timestamped records in RAM. Records are printed only after
        the display reports idle.

config PAPERS3_M5GFX_TRACE_CAPACITY
    int "Trace ring record capacity"
    depends on PAPERS3_M5GFX_RUNTIME_TRACE
    range 128 2048
    default 512

endmenu
```

## 0109-papers3-factory-v0.5-runtime-trace/main/Kconfig.projbuild
```kconfig
menu "FactoryTest V0.5 lineage runtime trace"

config PAPERS3_FACTORY_RUNTIME_TRACE
    bool "Enable fixed-ring M5GFX EPD runtime tracing"
    default n

config PAPERS3_FACTORY_TRACE_CAPACITY
    int "Trace ring record capacity"
    depends on PAPERS3_FACTORY_RUNTIME_TRACE
    range 512 2048
    default 1024

endmenu
```

## 0119-cores3-qrcode-minimal-probe/sdkconfig.defaults
```kconfig
CONFIG_IDF_TARGET="esp32s3"
CONFIG_ESPTOOLPY_FLASHSIZE_16MB=y
CONFIG_ESPTOOLPY_FLASHSIZE="16MB"
CONFIG_PARTITION_TABLE_CUSTOM=y
CONFIG_PARTITION_TABLE_CUSTOM_FILENAME="partitions.csv"
CONFIG_PARTITION_TABLE_FILENAME="partitions.csv"
CONFIG_ESPTOOLPY_FLASHMODE_QIO=y
CONFIG_ESPTOOLPY_FLASHFREQ_80M=y
CONFIG_SPIRAM=y
CONFIG_SPIRAM_MODE_QUAD=y
CONFIG_SPIRAM_SPEED_80M=y
CONFIG_SPIRAM_BOOT_INIT=y
CONFIG_SPIRAM_USE_MALLOC=y
CONFIG_ESP_DEFAULT_CPU_FREQ_MHZ_240=y
CONFIG_ESP_CONSOLE_USB_SERIAL_JTAG=y
# CONFIG_ESP_CONSOLE_UART_DEFAULT is not set
# CONFIG_ESP_CONSOLE_UART is not set
CONFIG_ESP_CONSOLE_SECONDARY_NONE=y
CONFIG_ESP_MAIN_TASK_STACK_SIZE=8192
CONFIG_FREERTOS_HZ=1000
CONFIG_LOG_COLORS=n
CONFIG_ESP_SYSTEM_PANIC_PRINT_REBOOT=y
```

## examples/nfc_engine_smoke/sdkconfig.defaults
```kconfig
# SPDX-License-Identifier: MIT
CONFIG_ESP_CONSOLE_USB_SERIAL_JTAG=y
# CONFIG_ESP_CONSOLE_UART is not set
```
