// SPDX-License-Identifier: MIT
//
// gogolem_nfc emulation smoke: starts the Engine in NTAG213 target mode and
// loops update_emulation(). The user validates by reading the emulated tag
// with a phone. Remove the physical NTAG215 from the antenna first.

#include "driver/i2c_master.h"
#include "freertos/FreeRTOS.h"
#include "freertos/task.h"

#include <cstdio>
#include <cstring>

#include "gogolem/nfc/engine.hpp"
#include "gogolem/nfc/types.hpp"

using namespace gogolem::nfc;

static i2c_master_bus_handle_t make_bus() {
    i2c_master_bus_handle_t bus{};
    i2c_master_bus_config_t cfg{};
    cfg.i2c_port = I2C_NUM_1;
    cfg.sda_io_num = GPIO_NUM_12;
    cfg.scl_io_num = GPIO_NUM_11;
    cfg.clk_source = I2C_CLK_SRC_DEFAULT;
    cfg.glitch_ignore_cnt = 7;
    cfg.intr_priority = 0;
    cfg.trans_queue_depth = 0;
    cfg.flags.enable_internal_pullup = 1;
    i2c_new_master_bus(&cfg, &bus);
    return bus;
}

// NTAG213 emulation profile (ported from 0117).
static constexpr uint8_t NTAG213_MEMORY[] = {
    0x00, 0x00, 0x00, 0x00, 0x00, 0x00, 0x00, 0x00,
    0x00, 0x48, 0x00, 0x00, 0xE1, 0x10, 0x12, 0x00,
    0x01, 0x03, 0xA0, 0x0C, 0x34, 0x03, 0x58, 0x91,
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    0x00, 0x00, 0x00, 0x00,
};

static const char* emu_state_name(EmulationState s) {
    switch (s) {
        case EmulationState::None: return "none";
        case EmulationState::Off: return "off";
        case EmulationState::Idle: return "idle";
        case EmulationState::Ready: return "ready";
        case EmulationState::Active: return "active";
        case EmulationState::Halt: return "halt";
        default: return "unknown";
    }
}

extern "C" void app_main(void) {
    printf("smoke emulation: remove physical tag, then scan with phone\n");
    i2c_master_bus_handle_t bus = make_bus();

    Engine engine;
    EngineConfig cfg{};
    cfg.bus = bus;
    cfg.mode = Mode::EmulationNtag213;
    cfg.emulation_profile.family = TagFamily::Ntag21x;
    cfg.emulation_profile.uid = {0x99, 0x88, 0x77, 0x66, 0x55, 0x44, 0x33, 0, 0, 0};
    cfg.emulation_profile.uid_length = 7;
    cfg.emulation_profile.memory.assign(std::begin(NTAG213_MEMORY), std::end(NTAG213_MEMORY));

    auto begin = engine.begin(cfg);
    printf("smoke begin ok=%u state=%s\n", begin.ok() ? 1u : 0u,
           lifecycle_state_name(engine.state()));

    EmulationState last = EmulationState::None;
    for (;;) {
        EmulationState s = engine.update_emulation();
        if (s != last) {
            printf("smoke emu state=%s\n", emu_state_name(s));
            last = s;
        }
        vTaskDelay(pdMS_TO_TICKS(1));
    }
}
