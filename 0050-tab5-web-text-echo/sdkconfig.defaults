## 0050-tab5-web-text-echo/sdkconfig.defaults
```kconfig
CONFIG_IDF_TARGET="esp32p4"
CONFIG_ESPTOOLPY_FLASHMODE_QIO=y
CONFIG_ESPTOOLPY_FLASHSIZE_16MB=y

# Console over USB Serial/JTAG, matching the other interactive esp32-s3-m5 tutorials.
CONFIG_ESP_CONSOLE_USB_SERIAL_JTAG=y
# CONFIG_ESP_CONSOLE_UART_DEFAULT is not set
# CONFIG_ESP_CONSOLE_UART_CUSTOM is not set
# CONFIG_ESP_CONSOLE_USB_CDC is not set
CONFIG_ESP_CONSOLE_SECONDARY_NONE=y
CONFIG_ESP_CONSOLE_USB_SERIAL_JTAG_ENABLED=y
CONFIG_ESP_CONSOLE_UART_NUM=-1

# ESP-Hosted + Wi-Fi remote support for ESP32-P4/Tab5.
CONFIG_ESP_HOSTED_ENABLED=y
CONFIG_ESP_HOSTED_PRIV_SDIO_OPTION=y
CONFIG_ESP_HOSTED_PRIV_SPI_HD_OPTION=y
CONFIG_ESP_HOSTED_SDIO_HOST_INTERFACE=y
CONFIG_ESP_HOSTED_IDF_SLAVE_TARGET="esp32c6"
CONFIG_ESP_HOSTED_SDIO_RESET_ACTIVE_LOW=y
CONFIG_ESP_HOSTED_SDIO_OPTIMIZATION_RX_STREAMING_MODE=y
CONFIG_ESP_HOSTED_SDIO_GPIO_RESET_SLAVE=15
CONFIG_ESP_HOSTED_SDIO_4_BIT_BUS=y
CONFIG_ESP_HOSTED_SDIO_BUS_WIDTH=4
CONFIG_ESP_HOSTED_SDIO_CLOCK_FREQ_KHZ=40000
CONFIG_ESP_HOSTED_SDIO_PIN_CMD=13
CONFIG_ESP_HOSTED_SDIO_PIN_CLK=12
CONFIG_ESP_HOSTED_SDIO_PIN_D0=11
CONFIG_ESP_HOSTED_SDIO_PRIV_PIN_D1_4BIT_BUS=10
CONFIG_ESP_HOSTED_SDIO_PIN_D1=10
CONFIG_ESP_HOSTED_SDIO_PIN_D2=9
CONFIG_ESP_HOSTED_SDIO_PIN_D3=8
CONFIG_ESP_HOSTED_SDIO_TX_Q_SIZE=20
CONFIG_ESP_HOSTED_SDIO_RX_Q_SIZE=20
CONFIG_ESP_HOSTED_GPIO_SLAVE_RESET_SLAVE=15
CONFIG_ESP_HOSTED_RESET_GPIO_ACTIVE_LOW=y
CONFIG_ESP_HOSTED_RPC_TASK_STACK=4096
CONFIG_ESP_HOSTED_DFLT_TASK_STACK=3072
CONFIG_ESP_HOSTED_USE_MEMPOOL=y
CONFIG_ESP_HOSTED_MAX_SIMULTANEOUS_SYNC_RPC_REQUESTS=5
CONFIG_ESP_HOSTED_MAX_SIMULTANEOUS_ASYNC_RPC_REQUESTS=5
CONFIG_ESP_HOSTED_HOST_TO_ESP_WIFI_DATA_THROTTLE=y
CONFIG_ESP_HOSTED_PRIV_WIFI_TX_SDIO_HIGH_THRESHOLD=80
CONFIG_ESP_HOSTED_TO_WIFI_DATA_THROTTLE_HIGH_THRESHOLD=80
CONFIG_ESP_HOSTED_TO_WIFI_DATA_THROTTLE_LOW_THRESHOLD=60

CONFIG_SLAVE_IDF_TARGET_ESP32C6=y
CONFIG_SLAVE_SOC_WIFI_SUPPORTED=y
CONFIG_SLAVE_SOC_WIFI_WAPI_SUPPORT=y
CONFIG_SLAVE_SOC_WIFI_CSI_SUPPORT=y
CONFIG_SLAVE_SOC_WIFI_MESH_SUPPORT=y
CONFIG_SLAVE_SOC_WIFI_LIGHT_SLEEP_CLK_WIDTH=12
CONFIG_SLAVE_SOC_WIFI_HW_TSF=y
CONFIG_SLAVE_SOC_WIFI_FTM_SUPPORT=y
CONFIG_SLAVE_FREERTOS_UNICORE=y
CONFIG_SLAVE_SOC_WIFI_GCMP_SUPPORT=y
CONFIG_SLAVE_IDF_TARGET_ARCH_RISCV=y
CONFIG_SLAVE_SOC_WIFI_HE_SUPPORT=y
CONFIG_SLAVE_SOC_WIFI_MAC_VERSION_NUM=2

CONFIG_ESP_WIFI_REMOTE_ENABLED=y
CONFIG_ESP_WIFI_REMOTE_LIBRARY_HOSTED=y
CONFIG_WIFI_RMT_STATIC_RX_BUFFER_NUM=10
CONFIG_WIFI_RMT_DYNAMIC_RX_BUFFER_NUM=32
CONFIG_WIFI_RMT_DYNAMIC_TX_BUFFER=y
CONFIG_WIFI_RMT_TX_BUFFER_TYPE=1
CONFIG_WIFI_RMT_DYNAMIC_TX_BUFFER_NUM=32
CONFIG_WIFI_RMT_STATIC_RX_MGMT_BUFFER=y
CONFIG_WIFI_RMT_DYNAMIC_RX_MGMT_BUF=0
CONFIG_WIFI_RMT_RX_MGMT_BUF_NUM_DEF=5
CONFIG_WIFI_RMT_AMPDU_TX_ENABLED=y
CONFIG_WIFI_RMT_AMPDU_RX_ENABLED=y
CONFIG_WIFI_RMT_NVS_ENABLED=y
CONFIG_WIFI_RMT_SOFTAP_SUPPORT=y
CONFIG_WIFI_RMT_ENABLE_WPA3_SAE=y
CONFIG_WIFI_RMT_MBEDTLS_CRYPTO=y
CONFIG_WIFI_RMT_MBEDTLS_TLS_CLIENT=y
CONFIG_WIFI_RMT_MGMT_SBUF_NUM=32
CONFIG_WIFI_RMT_IRAM_OPT=y
CONFIG_WIFI_RMT_EXTRA_IRAM_OPT=y
CONFIG_WIFI_RMT_RX_IRAM_OPT=y
CONFIG_WIFI_RMT_SLP_IRAM_OPT=y
CONFIG_WIFI_RMT_STA_DISCONNECTED_PM_ENABLE=y
CONFIG_WIFI_RMT_GMAC_SUPPORT=y
CONFIG_WIFI_RMT_ESPNOW_MAX_ENCRYPT_NUM=7
```

## 0067-esp-c3-led-matrix-http/main/Kconfig.projbuild
```kconfig
menu "0067: ESP32-C3 LED matrix HTTP"

config TUTORIAL_0067_MATRIX_PIN_MOSI
    int "MAX7219 DIN (MOSI) GPIO"
    range 0 21
    default 4

config TUTORIAL_0067_MATRIX_PIN_CS
    int "MAX7219 CS GPIO"
    range 0 21
    default 5

config TUTORIAL_0067_MATRIX_PIN_SCK
    int "MAX7219 CLK (SCK) GPIO"
    range 0 21
    default 6

config TUTORIAL_0067_MATRIX_CHAIN_LEN
    int "MAX7219 chain length"
    range 1 16
    default 12

config TUTORIAL_0067_MATRIX_SPI_HZ
    int "MAX7219 SPI clock (Hz)"
    range 1000 10000000
    default 100000

config TUTORIAL_0067_MATRIX_DEFAULT_FPS
    int "Default animation FPS"
    range 1 60
    default 15

config TUTORIAL_0067_HTTP_MAX_BODY
    int "Max HTTP body bytes"
    range 64 4096
    default 512

endmenu
```

## 0067-esp-c3-led-matrix-http/sdkconfig.defaults
```kconfig
CONFIG_ESP_CONSOLE_UART_DEFAULT=y
CONFIG_ESP_CONSOLE_UART=y
CONFIG_ESP_CONSOLE_UART_NUM=0
CONFIG_ESP_CONSOLE_UART_BAUDRATE=115200
CONFIG_ESP_CONSOLE_USB_SERIAL_JTAG=n
CONFIG_ESP_CONSOLE_USB_SERIAL_JTAG_ENABLED=n
CONFIG_LOG_DEFAULT_LEVEL_INFO=y
```

## 0071-cardputer-adv-photo-timer/main/Kconfig.projbuild
```kconfig
menu "0071 Cardputer-ADV Photo Timer"

config PHOTO_TIMER_ENCODER_UART_NUM
    int "Chain Encoder UART port number"
    range 0 2
    default 1

config PHOTO_TIMER_ENCODER_BAUD
    int "Chain Encoder baud rate"
    range 1200 3000000
    default 115200

config PHOTO_TIMER_ENCODER_TX_GPIO
    int "Chain Encoder TX GPIO"
    range 0 48
    default 2

config PHOTO_TIMER_ENCODER_RX_GPIO
    int "Chain Encoder RX GPIO"
    range 0 48
    default 1

config PHOTO_TIMER_ENCODER_INDEX_ID
    int "Chain Encoder index_id"
    range 1 255
    default 1

config PHOTO_TIMER_ENCODER_POLL_MS
    int "Chain Encoder polling interval (ms)"
    range 5 500
    default 20

config PHOTO_TIMER_ENCODER_DELTA_CLAMP
    int "Clamp absolute delta per LVGL read (0 disables)"
    range 0 100
    default 10

config PHOTO_TIMER_STATUS_REFRESH_MS
    int "Status label refresh interval (ms)"
    range 50 2000
    default 200

config PHOTO_TIMER_HTTP_MAX_BODY
    int "Max HTTP request body bytes"
    range 1024 262144
    default 65536

config PHOTO_TIMER_SPIFFS_FORMAT_IF_MOUNT_FAILED
    bool "Format SPIFFS if mount failed"
    default y

config PHOTO_TIMER_WIFI_ENABLE
    bool "Enable Wi-Fi manager + HTTP UI"
    default y

endmenu
```

## 0072-m5dial-timer-demo/sdkconfig.defaults
```kconfig
# Tutorial 0072 defaults (ESP-IDF 5.4.1)

CONFIG_ESPTOOLPY_FLASHSIZE_8MB=y
CONFIG_ESPTOOLPY_FLASHSIZE="8MB"

CONFIG_PARTITION_TABLE_CUSTOM=y
CONFIG_PARTITION_TABLE_CUSTOM_FILENAME="partitions.csv"
CONFIG_PARTITION_TABLE_FILENAME="partitions.csv"

CONFIG_ESP_DEFAULT_CPU_FREQ_MHZ_240=y
CONFIG_ESP_DEFAULT_CPU_FREQ_MHZ=240

CONFIG_ESP_MAIN_TASK_STACK_SIZE=8192

CONFIG_COMPILER_CXX_EXCEPTIONS=n

CONFIG_LOG_DEFAULT_LEVEL_INFO=y

# LVGL is needed in later milestones.
# Keep examples off so the project stays small.
# CONFIG_LV_BUILD_EXAMPLES is not set
CONFIG_LV_MEM_SIZE_KILOBYTES=64
CONFIG_LV_FONT_MONTSERRAT_18=y
CONFIG_LV_FONT_MONTSERRAT_20=y
CONFIG_LV_FONT_MONTSERRAT_48=y
```

## 0074-m5dial-web-remote/firmware/main/Kconfig.projbuild
```kconfig
menu "0074 M5Dial Lain JS Runtime"

config TUTORIAL_0074_JS_MAX_BODY
    int "Max inbound script body bytes"
    default 4096

config TUTORIAL_0074_JS_MEM_BYTES
    int "MicroQuickJS memory pool bytes"
    default 65536

config TUTORIAL_0074_JS_TIMEOUT_MS
    int "Script eval timeout in milliseconds"
    default 1500

config TUTORIAL_0074_JS_QUEUE_LEN
    int "Queued remote script requests"
    range 1 16
    default 4

endmenu
```

## 0074-m5dial-web-remote/firmware/sdkconfig.defaults
```kconfig
# M5Dial hardware defaults
CONFIG_ESPTOOLPY_FLASHSIZE_8MB=y
CONFIG_ESPTOOLPY_FLASHSIZE="8MB"
CONFIG_PARTITION_TABLE_CUSTOM=y
CONFIG_PARTITION_TABLE_CUSTOM_FILENAME="partitions.csv"
CONFIG_PARTITION_TABLE_FILENAME="partitions.csv"

CONFIG_ESP_DEFAULT_CPU_FREQ_MHZ_240=y
CONFIG_ESP_DEFAULT_CPU_FREQ_MHZ=240
CONFIG_ESP_MAIN_TASK_STACK_SIZE=8192

CONFIG_COMPILER_CXX_EXCEPTIONS=n
CONFIG_LOG_DEFAULT_LEVEL_INFO=y

# Prefer USB Serial/JTAG so ACM0 remains the console path.
CONFIG_ESP_CONSOLE_USB_SERIAL_JTAG=y
# CONFIG_ESP_CONSOLE_UART is not set
CONFIG_ESP_CONSOLE_SECONDARY_NONE=y
CONFIG_ESP_CONSOLE_USB_SERIAL_JTAG_ENABLED=y
CONFIG_ESP_CONSOLE_UART_NUM=-1

# Wi-Fi / websocket runtime.
CONFIG_WS_TRANSPORT=y
CONFIG_WIFI_MGR_MAX_RETRY=10
CONFIG_WIFI_CONSOLE_MAX_SCAN_RESULTS=32
```

## 0079-papers3-wamr-assemblyscript-console/main/Kconfig.projbuild
```kconfig
menu "PaperS3 WAMR AssemblyScript Console"

config PAPERS3_WASM_ENABLE_DISPLAY_STACK
    bool "Enable PaperS3 display stack for WAMR demo"
    default y
    help
        When enabled, the firmware initializes the PaperS3 display path, registers
        WAMR drawing imports, and enables `wasm replay ...` control examples.

        When disabled, the firmware becomes a headless PaperS3 WAMR baseline:
        no board splash via `M5.Display`, no `PaperCanvas` initialization, and no
        display-oriented WAMR host imports. This is intended for isolating whether
        WAMR execution alone can destabilize the later PaperS3 display path.

endmenu
```

## 0080-papers3-ereader/sdkconfig.defaults
```kconfig
# PaperS3 target and flash layout
CONFIG_IDF_TARGET="esp32s3"
CONFIG_ESPTOOLPY_FLASHSIZE_16MB=y
CONFIG_ESPTOOLPY_FLASHSIZE="16MB"
CONFIG_PARTITION_TABLE_CUSTOM=y
CONFIG_PARTITION_TABLE_CUSTOM_FILENAME="partitions.csv"
CONFIG_PARTITION_TABLE_FILENAME="partitions.csv"

# Memory and task sizing
CONFIG_SPIRAM=y
CONFIG_SPIRAM_MODE_OCT=y
CONFIG_ESP_MAIN_TASK_STACK_SIZE=12288
CONFIG_COMPILER_ORPHAN_SECTIONS_WARNING=y

# USB Serial/JTAG for esp_console REPL
CONFIG_ESP_CONSOLE_USB_SERIAL_JTAG=y
# CONFIG_ESP_CONSOLE_UART_DEFAULT is not set
# CONFIG_ESP_CONSOLE_UART is not set
CONFIG_ESP_CONSOLE_SECONDARY_NONE=y

CONFIG_LOG_COLORS=n
```

## 0081-atoms3r-wamr-probe-console/sdkconfig.defaults
```kconfig
# AtomS3R WAMR probe defaults (ESP-IDF 5.3.4)

CONFIG_IDF_TARGET="esp32s3"

# Flash and partitions
CONFIG_ESPTOOLPY_FLASHSIZE_8MB=y
CONFIG_ESPTOOLPY_FLASHSIZE="8MB"
CONFIG_PARTITION_TABLE_CUSTOM=y
CONFIG_PARTITION_TABLE_CUSTOM_FILENAME="partitions.csv"
CONFIG_PARTITION_TABLE_FILENAME="partitions.csv"

# CPU and memory
CONFIG_ESP_DEFAULT_CPU_FREQ_MHZ_240=y
CONFIG_ESP_DEFAULT_CPU_FREQ_MHZ=240
CONFIG_ESP_MAIN_TASK_STACK_SIZE=12288
CONFIG_SPIRAM=y
CONFIG_SPIRAM_MODE_OCT=y

# AtomS3R display and backlight defaults
CONFIG_TUTORIAL_0013_LCD_Y_OFFSET=32
CONFIG_TUTORIAL_0013_LCD_SPI_PCLK_HZ=40000000
CONFIG_TUTORIAL_0013_CANVAS_USE_PSRAM=n
CONFIG_TUTORIAL_0013_PRESENT_USE_DMA=y
CONFIG_TUTORIAL_0013_BACKLIGHT_GATE_ENABLE=y
CONFIG_TUTORIAL_0013_BACKLIGHT_GATE_GPIO=7
CONFIG_TUTORIAL_0013_BACKLIGHT_GATE_ACTIVE_LOW=y
CONFIG_TUTORIAL_0013_BACKLIGHT_I2C_ENABLE=y
CONFIG_TUTORIAL_0013_BL_I2C_SCL_GPIO=0
CONFIG_TUTORIAL_0013_BL_I2C_SDA_GPIO=45
CONFIG_TUTORIAL_0013_BL_I2C_ADDR=0x30
CONFIG_TUTORIAL_0013_BL_I2C_REG=0x0e
CONFIG_TUTORIAL_0013_BL_BRIGHTNESS_ON=255

# Prefer USB Serial/JTAG for the interactive console on S3 boards
CONFIG_ESP_CONSOLE_USB_SERIAL_JTAG=y
CONFIG_ESP_CONSOLE_UART_DEFAULT=n
CONFIG_ESP_CONSOLE_UART_CUSTOM=n
CONFIG_ESP_CONSOLE_SECONDARY_NONE=y
CONFIG_TUTORIAL_0013_CONSOLE_BINDING_USB_SERIAL_JTAG=y
CONFIG_TUTORIAL_0013_CONSOLE_PROMPT="atom> "

# Logging quality-of-life
CONFIG_LOG_COLORS=n

# WAMR baseline: interpreter first, feature set kept intentionally narrow
CONFIG_WAMR_ENABLE_AOT=n
CONFIG_WAMR_ENABLE_INTERP=y
CONFIG_WAMR_INTERP_FAST=y
CONFIG_WAMR_ENABLE_LIB_PTHREAD=n
CONFIG_WAMR_ENABLE_LIBC_BUILTIN=y
CONFIG_WAMR_ENABLE_LIBC_WASI=n
CONFIG_WAMR_ENABLE_MULTI_MODULE=n
CONFIG_WAMR_ENABLE_SHARED_MEMORY=n
CONFIG_WAMR_ENABLE_REF_TYPES=n
```

## 0082-papers3-wamr-allocator-control/main/Kconfig.projbuild
```kconfig
menu "PaperS3 WAMR Allocator Control"

choice PAPERS3_WAMR_ALLOCATOR_BACKING
    prompt "WAMR allocator backing"
    default PAPERS3_WAMR_ALLOCATOR_POOL_SPIRAM
    help
        Select how the allocator-control firmware backs WAMR runtime allocations.

config PAPERS3_WAMR_ALLOCATOR_POOL_SPIRAM
    bool "Pool allocator backed by external SPIRAM"

config PAPERS3_WAMR_ALLOCATOR_POOL_INTERNAL
    bool "Pool allocator backed by internal RAM"

config PAPERS3_WAMR_ALLOCATOR_SYSTEM
    bool "System allocator"

endchoice

config PAPERS3_WAMR_COPY_EMBEDDED_TO_INTERNAL_BEFORE_LOAD
    bool "Copy embedded Wasm into internal RAM before load"
    default n
    help
        When enabled, the default embedded-module path copies the embedded Wasm
        bytes into internal RAM before calling wasm_runtime_load(). This exists
        as a mitigation experiment for the PaperS3 flash-mapped embedded-buffer
        contamination issue.

endmenu
```

## 0082-papers3-wamr-allocator-control/sdkconfig.defaults
```kconfig
# PaperS3 target and flash layout
CONFIG_IDF_TARGET="esp32s3"
CONFIG_ESPTOOLPY_FLASHSIZE_16MB=y
CONFIG_ESPTOOLPY_FLASHSIZE="16MB"
CONFIG_PARTITION_TABLE_CUSTOM=y
CONFIG_PARTITION_TABLE_CUSTOM_FILENAME="partitions.csv"
CONFIG_PARTITION_TABLE_FILENAME="partitions.csv"

# Memory and task sizing
CONFIG_SPIRAM=y
CONFIG_SPIRAM_MODE_OCT=y
CONFIG_ESP_MAIN_TASK_STACK_SIZE=12288
CONFIG_COMPILER_ORPHAN_SECTIONS_WARNING=y

# Prefer USB Serial/JTAG for the interactive console on PaperS3
CONFIG_ESP_CONSOLE_USB_SERIAL_JTAG=y
# CONFIG_ESP_CONSOLE_UART_DEFAULT is not set
# CONFIG_ESP_CONSOLE_UART is not set
CONFIG_ESP_CONSOLE_SECONDARY_NONE=y

# Console quality-of-life
CONFIG_LOG_COLORS=n

# WAMR baseline: interpreter first, keep feature set narrow
CONFIG_PAPERS3_WAMR_COPY_EMBEDDED_TO_INTERNAL_BEFORE_LOAD=y
CONFIG_WAMR_ENABLE_AOT=n
CONFIG_WAMR_ENABLE_INTERP=y
CONFIG_WAMR_INTERP_FAST=y
CONFIG_WAMR_ENABLE_LIB_PTHREAD=n
CONFIG_WAMR_ENABLE_LIBC_BUILTIN=y
CONFIG_WAMR_ENABLE_LIBC_WASI=n
CONFIG_WAMR_ENABLE_MULTI_MODULE=n
CONFIG_WAMR_ENABLE_SHARED_MEMORY=n
CONFIG_WAMR_ENABLE_REF_TYPES=n
```

## 0083-cardputer-adv-animation-ui/main/Kconfig.projbuild
```kconfig
menu "0083: Cardputer-ADV animation UI"

config TUTORIAL_0083_FRAME_MS
    int "Frame time (ms)"
    range 1 1000
    default 16
    help
        Delay between UI frames. Lower is smoother but uses more CPU.

config TUTORIAL_0083_CANVAS_USE_PSRAM
    bool "Allocate M5Canvas sprite in PSRAM"
    default n
    help
        PSRAM sprites typically disable DMA paths; keep disabled for best performance.

config TUTORIAL_0083_PRESENT_WAIT_DMA
    bool "Wait for DMA after present"
    default y
    help
        Conservative display safety: wait for any DMA transfer to finish after pushSprite.

config TUTORIAL_0083_LINE_COUNT
    int "Virtual line count"
    range 8 128
    default 40
    help
        Number of logical line markers shown in the minimap and viewport.

config TUTORIAL_0083_AUTOPLAY_PERIOD_MS
    int "Autoplay step period (ms)"
    range 10 1000
    default 60
    help
        Period for the automatic demo-scroll mode.

endmenu
```

## 0083-cardputer-adv-animation-ui/sdkconfig.defaults
```kconfig
# Tutorial 0083 defaults (ESP-IDF 5.4.x)
#
# Cardputer-ADV modern animation UI.
#

CONFIG_ESPTOOLPY_FLASHSIZE_8MB=y
CONFIG_ESPTOOLPY_FLASHSIZE="8MB"

CONFIG_PARTITION_TABLE_CUSTOM=y
CONFIG_PARTITION_TABLE_CUSTOM_FILENAME="partitions.csv"
CONFIG_PARTITION_TABLE_FILENAME="partitions.csv"

CONFIG_ESP_DEFAULT_CPU_FREQ_MHZ_240=y
CONFIG_ESP_DEFAULT_CPU_FREQ_MHZ=240

CONFIG_ESP_MAIN_TASK_STACK_SIZE=8000

CONFIG_ESP_CONSOLE_USB_SERIAL_JTAG=y
CONFIG_ESP_CONSOLE_UART_DEFAULT=n
CONFIG_ESP_CONSOLE_UART_CUSTOM=n
CONFIG_ESP_CONSOLE_USB_CDC=n

CONFIG_TUTORIAL_0083_FRAME_MS=16
CONFIG_TUTORIAL_0083_CANVAS_USE_PSRAM=n
CONFIG_TUTORIAL_0083_PRESENT_WAIT_DMA=y
CONFIG_TUTORIAL_0083_LINE_COUNT=40
CONFIG_TUTORIAL_0083_AUTOPLAY_PERIOD_MS=60
```
