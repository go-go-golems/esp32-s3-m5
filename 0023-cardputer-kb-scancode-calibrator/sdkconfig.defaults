## 0046-xiao-esp32c6-led-patterns-webui/main/Kconfig.projbuild
```kconfig
menu "MO-032: WS281x patterns + console"

config MO032_WS281X_GPIO_NUM
    int "Data GPIO (XIAO D1 default)"
    range 0 48
    default 1
    help
        Data output GPIO used to drive the strip.

        For Seeed XIAO ESP32C6, D1 maps to GPIO1.

config MO032_WS281X_LED_COUNT
    int "LED count"
    range 1 1024
    default 50
    help
        Number of addressable LEDs in the chain.

config MO032_WS281X_BRIGHTNESS_PCT
    int "Global brightness (%)"
    range 1 100
    default 25
    help
        Global brightness scaler applied to RGB values before sending.

config MO032_ANIM_FRAME_MS
    int "Animation frame time (ms)"
    range 1 1000
    default 16
    help
        Delay between frames. Lower is smoother but uses more CPU.

config MO032_WS281X_T0H_NS
    int "T0H (ns)"
    range 50 2000
    default 350
    help
        High time for a logical 0 bit.

config MO032_WS281X_T0L_NS
    int "T0L (ns)"
    range 50 2000
    default 800
    help
        Low time for a logical 0 bit.

config MO032_WS281X_T1H_NS
    int "T1H (ns)"
    range 50 2000
    default 700
    help
        High time for a logical 1 bit.

config MO032_WS281X_T1L_NS
    int "T1L (ns)"
    range 50 2000
    default 600
    help
        Low time for a logical 1 bit.

config MO032_WS281X_RESET_US
    int "Reset time (us)"
    range 10 500
    default 80
    help
        Low reset time after sending a frame.

endmenu

menu "MO-033: Wi-Fi + embedded web UI"

comment "Wi-Fi settings are provided by components/wifi_mgr (CONFIG_WIFI_MGR_*)"

config MO033_HTTP_CACHE_NO_STORE
    bool "Serve Cache-Control: no-store for static assets"
    default y
    help
        Deterministic asset filenames can cause confusing browser caching during development.
        If enabled, static asset handlers add Cache-Control: no-store.

endmenu
```

## 0047-cardputer-adv-lvgl-chain-encoder-list/main/Kconfig.projbuild
```kconfig
menu "Tutorial 0047: Cardputer-ADV LVGL List + Chain Encoder"

config TUTORIAL_0047_UART_NUM
    int "Chain Encoder UART port number (controller)"
    range 0 2
    default 1

config TUTORIAL_0047_UART_BAUD
    int "Chain Encoder baud rate"
    range 1200 3000000
    default 115200

config TUTORIAL_0047_UART_TX_GPIO
    int "Chain Encoder UART TX GPIO (default: G2)"
    range 0 48
    default 2

config TUTORIAL_0047_UART_RX_GPIO
    int "Chain Encoder UART RX GPIO (default: G1)"
    range 0 48
    default 1

config TUTORIAL_0047_CHAIN_INDEX_ID
    int "Chain Index_id (1 for single device)"
    range 1 255
    default 1

config TUTORIAL_0047_POLL_MS
    int "Polling interval for encoder delta (ms)"
    range 5 500
    default 20

config TUTORIAL_0047_DELTA_CLAMP
    int "Clamp absolute delta per LVGL read (0 disables)"
    range 0 100
    default 10

endmenu
```

## 0047-cardputer-adv-lvgl-chain-encoder-list/sdkconfig.defaults
```kconfig
# Tutorial 0047 defaults (ESP-IDF 5.4.1)

# Flash size: Cardputer is commonly 8MB.
CONFIG_ESPTOOLPY_FLASHSIZE_8MB=y
CONFIG_ESPTOOLPY_FLASHSIZE="8MB"

# Partition table: project-local partitions.csv (factory 4M + storage 1M).
CONFIG_PARTITION_TABLE_CUSTOM=y
CONFIG_PARTITION_TABLE_CUSTOM_FILENAME="partitions.csv"
CONFIG_PARTITION_TABLE_FILENAME="partitions.csv"

# CPU frequency.
CONFIG_ESP_DEFAULT_CPU_FREQ_MHZ_240=y
CONFIG_ESP_DEFAULT_CPU_FREQ_MHZ=240

# Main task stack: LVGL + M5GFX are C++ and can be stack-hungry.
CONFIG_ESP_MAIN_TASK_STACK_SIZE=10000

# LVGL tuning (keep build small and memory predictable).
# CONFIG_LV_BUILD_EXAMPLES is not set
CONFIG_LV_MEM_SIZE_KILOBYTES=64
CONFIG_LV_FONT_MONTSERRAT_14=y

# Console output channel: USB Serial/JTAG (avoid corrupting the Grove UART protocol).
CONFIG_ESP_CONSOLE_USB_SERIAL_JTAG=y
# CONFIG_ESP_CONSOLE_UART_DEFAULT is not set
CONFIG_ESP_CONSOLE_SECONDARY_NONE=y
```

## 0048-cardputer-js-web/main/Kconfig.projbuild
```kconfig
menu "0048 Cardputer Web JS IDE"

comment "Wi-Fi settings are provided by components/wifi_mgr (CONFIG_WIFI_MGR_*)"

config TUTORIAL_0048_JS_MAX_BODY
    int "Max JS request body bytes"
    default 16384

config TUTORIAL_0048_JS_MEM_BYTES
    int "MicroQuickJS memory pool bytes"
    default 65536

config TUTORIAL_0048_JS_TIMEOUT_MS
    int "Eval timeout in milliseconds (0 disables)"
    default 2000

menu "Phase 2: Encoder telemetry (WebSocket)"

config TUTORIAL_0048_ENCODER_CHAIN_UART
    bool "Enable M5 Chain Encoder (U207) over Grove UART"
    default n
    help
        If enabled, start a background task that polls a Chain Encoder over UART
        and broadcasts telemetry JSON frames over WebSocket (/ws).

config TUTORIAL_0048_CHAIN_ENCODER_UART_NUM
    int "Chain Encoder UART port number"
    depends on TUTORIAL_0048_ENCODER_CHAIN_UART
    default 1

config TUTORIAL_0048_CHAIN_ENCODER_BAUD
    int "Chain Encoder baud rate"
    depends on TUTORIAL_0048_ENCODER_CHAIN_UART
    default 115200

config TUTORIAL_0048_CHAIN_ENCODER_TX_GPIO
    int "Chain Encoder TX GPIO (device -> encoder)"
    depends on TUTORIAL_0048_ENCODER_CHAIN_UART
    default 2

config TUTORIAL_0048_CHAIN_ENCODER_RX_GPIO
    int "Chain Encoder RX GPIO (encoder -> device)"
    depends on TUTORIAL_0048_ENCODER_CHAIN_UART
    default 1

config TUTORIAL_0048_CHAIN_ENCODER_INDEX_ID
    int "Chain Encoder index_id"
    depends on TUTORIAL_0048_ENCODER_CHAIN_UART
    range 1 255
    default 1

config TUTORIAL_0048_CHAIN_ENCODER_POLL_MS
    int "Chain Encoder polling interval (ms)"
    depends on TUTORIAL_0048_ENCODER_CHAIN_UART
    range 5 200
    default 20

config TUTORIAL_0048_ENCODER_WS_BROADCAST_MS
    int "WebSocket broadcast interval (ms)"
    depends on TUTORIAL_0048_ENCODER_CHAIN_UART
    range 10 1000
    default 50

endmenu

endmenu
```
