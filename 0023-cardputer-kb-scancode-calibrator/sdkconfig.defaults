## 0023-cardputer-kb-scancode-calibrator/sdkconfig.defaults
```kconfig
# Defaults (ESP-IDF 5.4.1)

# Flash size: Cardputer is commonly 8MB.
CONFIG_ESPTOOLPY_FLASHSIZE_8MB=y
CONFIG_ESPTOOLPY_FLASHSIZE="8MB"

# Partition table: project-local partitions.csv.
CONFIG_PARTITION_TABLE_CUSTOM=y
CONFIG_PARTITION_TABLE_CUSTOM_FILENAME="partitions.csv"
CONFIG_PARTITION_TABLE_FILENAME="partitions.csv"

# CPU frequency: Cardputer demos usually run at 240MHz.
CONFIG_ESP_DEFAULT_CPU_FREQ_MHZ_240=y
CONFIG_ESP_DEFAULT_CPU_FREQ_MHZ=240

# Main task stack: C++ + M5GFX.
CONFIG_ESP_MAIN_TASK_STACK_SIZE=8000
```

## 0025-cardputer-lvgl-demo/main/Kconfig.projbuild
```kconfig
menu "0025 Cardputer LVGL Demo"

config 0025_SDCARD_MOUNT_PATH
    string "MicroSD mount path"
    default "/sd"
    help
        Base path where the MicroSD FATFS is mounted.

config 0025_SDCARD_PIN_MISO
    int "MicroSD (SDSPI) MISO GPIO"
    default 39
    help
        Cardputer MicroSD wiring reference (vendor demo): GPIO39.

config 0025_SDCARD_PIN_MOSI
    int "MicroSD (SDSPI) MOSI GPIO"
    default 14
    help
        Cardputer MicroSD wiring reference (vendor demo): GPIO14.

config 0025_SDCARD_PIN_SCK
    int "MicroSD (SDSPI) SCK GPIO"
    default 40
    help
        Cardputer MicroSD wiring reference (vendor demo): GPIO40.

config 0025_SDCARD_PIN_CS
    int "MicroSD (SDSPI) CS GPIO"
    default 12
    help
        Cardputer MicroSD wiring reference (vendor demo): GPIO12.

endmenu
```

## 0025-cardputer-lvgl-demo/sdkconfig.defaults
```kconfig
# Cardputer LVGL demo defaults (ESP-IDF 5.4.1)

# Flash size: Cardputer is commonly 8MB.
CONFIG_ESPTOOLPY_FLASHSIZE_8MB=y
CONFIG_ESPTOOLPY_FLASHSIZE="8MB"

# Partition table: project-local partitions.csv (factory 4M + storage 1M).
CONFIG_PARTITION_TABLE_CUSTOM=y
CONFIG_PARTITION_TABLE_CUSTOM_FILENAME="partitions.csv"
CONFIG_PARTITION_TABLE_FILENAME="partitions.csv"

# CPU frequency: Cardputer demos usually run at 240MHz.
CONFIG_ESP_DEFAULT_CPU_FREQ_MHZ_240=y
CONFIG_ESP_DEFAULT_CPU_FREQ_MHZ=240

# Main task stack: LVGL + M5GFX are C++ and can be stack-hungry.
CONFIG_ESP_MAIN_TASK_STACK_SIZE=10000

# LVGL tuning (keep build small and memory predictable).
# The LVGL managed component uses Kconfig; this disables compiling the full examples set.
# CONFIG_LV_BUILD_EXAMPLES is not set
CONFIG_LV_MEM_SIZE_KILOBYTES=64

# Fonts (needed for the Pomodoro "premium" layout).
CONFIG_LV_FONT_MONTSERRAT_12=y
CONFIG_LV_FONT_MONTSERRAT_32=y

# esp_console REPL over USB-Serial/JTAG (host scripting + screenshot capture).
# Note: this selects USB-Serial/JTAG as the primary console output channel.
CONFIG_ESP_CONSOLE_USB_SERIAL_JTAG=y
# CONFIG_ESP_CONSOLE_UART_DEFAULT is not set
# CONFIG_ESP_CONSOLE_SECONDARY_USB_SERIAL_JTAG is not set
CONFIG_ESP_CONSOLE_SECONDARY_NONE=y
```

## 0028-cardputer-esp-event-demo/main/Kconfig.projbuild
```kconfig
menu "Tutorial 0028: Cardputer esp_event demo"

config TUTORIAL_0028_EVENT_QUEUE_SIZE
    int "Event loop queue size"
    range 8 256
    default 32
    help
        Queue size for the application event loop created via esp_event_loop_create().

config TUTORIAL_0028_DISPATCH_TICKS
    int "UI dispatch budget (ticks)"
    range 0 100
    default 1
    help
        Each UI loop iteration calls esp_event_loop_run(loop, ticks).
        This sets the max time spent waiting on events before returning to rendering.
        If you set this too high, rendering may stutter; too low increases CPU usage.

config TUTORIAL_0028_UI_MAX_LINES
    int "UI log max lines"
    range 32 2048
    default 256
    help
        Maximum number of log lines kept in memory for the on-screen event log.

config TUTORIAL_0028_UI_TARGET_FPS
    int "UI target FPS"
    range 1 60
    default 30
    help
        Maximum redraw rate for the UI. Redraws are skipped if nothing is dirty.

config TUTORIAL_0028_KB_SCAN_PERIOD_MS
    int "Keyboard scan period (ms)"
    range 1 100
    default 10
    help
        Polling period for the Cardputer keyboard matrix scanner.

config TUTORIAL_0028_RAND_PRODUCERS
    int "Random event producers"
    range 0 8
    default 3
    help
        Number of background tasks generating random events.

config TUTORIAL_0028_RAND_MIN_PERIOD_MS
    int "Random producer min period (ms)"
    range 10 10000
    default 200
    help
        Lower bound for random producer delay between posts.

config TUTORIAL_0028_RAND_MAX_PERIOD_MS
    int "Random producer max period (ms)"
    range 10 60000
    default 1200
    help
        Upper bound for random producer delay between posts.

config TUTORIAL_0028_HEARTBEAT_PERIOD_MS
    int "Heartbeat period (ms)"
    range 100 60000
    default 1000
    help
        Period for the heartbeat task to post memory statistics events.

endmenu
```

## 0029-mock-zigbee-http-hub/main/Kconfig.projbuild
```kconfig
menu "Tutorial 0029: Mock Zigbee HTTP hub"

config TUTORIAL_0029_ENABLE_WS_PB
    bool "Enable WebSocket protobuf event stream (/v1/events/ws)"
    default y
    help
        When enabled, the hub publishes bus events as protobuf envelopes over a WebSocket
        as binary frames.

config TUTORIAL_0029_QUIET_LOGS_WHILE_CONSOLE
    bool "Reduce hub logs while console is running"
    default y
    help
        When enabled, hub component log levels are lowered after esp_console starts so the
        interactive prompt stays usable (less interleaved logging).

config TUTORIAL_0029_WIFI_SSID
    string "WiFi SSID (STA)"
    default ""

config TUTORIAL_0029_WIFI_PASSWORD
    string "WiFi password (STA)"
    default ""

config TUTORIAL_0029_WIFI_CONNECT_TIMEOUT_MS
    int "WiFi connect timeout (ms)"
    range 1000 60000
    default 15000

config TUTORIAL_0029_WIFI_MAX_RETRY
    int "WiFi max reconnect retries"
    range 0 100
    default 10

config TUTORIAL_0029_HUB_EVENT_QUEUE_SIZE
    int "Hub esp_event queue size"
    range 8 256
    default 64

config TUTORIAL_0029_SIM_PERIOD_MS
    int "Device simulator tick period (ms)"
    range 100 60000
    default 1000

endmenu
```

## 0029-mock-zigbee-http-hub/sdkconfig.defaults
```kconfig
# Tutorial 0029 defaults (ESP-IDF 5.4.x)

CONFIG_ESPTOOLPY_FLASHSIZE_8MB=y
CONFIG_ESPTOOLPY_FLASHSIZE="8MB"

CONFIG_PARTITION_TABLE_CUSTOM=y
CONFIG_PARTITION_TABLE_CUSTOM_FILENAME="partitions.csv"
CONFIG_PARTITION_TABLE_FILENAME="partitions.csv"

CONFIG_ESP_DEFAULT_CPU_FREQ_MHZ_240=y
CONFIG_ESP_DEFAULT_CPU_FREQ_MHZ=240

CONFIG_ESP_MAIN_TASK_STACK_SIZE=8000

# Enable HTTPD WebSocket support for /v1/events/ws.
CONFIG_HTTPD_WS_SUPPORT=y

# WS protobuf event stream is implemented but kept disabled by default until
# Wi-Fi + HTTP bring-up is stable in your environment.
# (Enable via menuconfig: Tutorial 0029: Mock Zigbee HTTP hub)
# CONFIG_TUTORIAL_0029_ENABLE_WS_PB is not set

# Reduce hub logs once the console REPL is running (keeps `hub>` usable).
CONFIG_TUTORIAL_0029_QUIET_LOGS_WHILE_CONSOLE=y

# Use USB Serial/JTAG as the primary console channel (Cardputer-friendly).
CONFIG_ESP_CONSOLE_USB_SERIAL_JTAG=y
CONFIG_ESP_CONSOLE_UART_DEFAULT=n
CONFIG_ESP_CONSOLE_UART_CUSTOM=n
CONFIG_ESP_CONSOLE_USB_CDC=n
```

## 0030-cardputer-console-eventbus/main/Kconfig.projbuild
```kconfig
menu "Tutorial 0030: Cardputer console + esp_event bus"

config TUTORIAL_0030_EVENT_QUEUE_SIZE
    int "Event loop queue size"
    range 8 256
    default 48

config TUTORIAL_0030_DISPATCH_TICKS
    int "UI dispatch budget (ticks)"
    range 0 100
    default 1
    help
        Each UI loop iteration calls esp_event_loop_run(loop, ticks).

config TUTORIAL_0030_UI_MAX_LINES
    int "UI log max lines"
    range 32 2048
    default 256

config TUTORIAL_0030_UI_TARGET_FPS
    int "UI target FPS"
    range 1 60
    default 30

config TUTORIAL_0030_KB_SCAN_PERIOD_MS
    int "Keyboard scan period (ms)"
    range 1 100
    default 10

config TUTORIAL_0030_RAND_PRODUCERS
    int "Random event producers"
    range 0 8
    default 2

config TUTORIAL_0030_RAND_MIN_PERIOD_MS
    int "Random producer min period (ms)"
    range 10 10000
    default 250

config TUTORIAL_0030_RAND_MAX_PERIOD_MS
    int "Random producer max period (ms)"
    range 10 60000
    default 1200

config TUTORIAL_0030_HEARTBEAT_PERIOD_MS
    int "Heartbeat period (ms)"
    range 100 60000
    default 1000

endmenu
```

## 0030-cardputer-console-eventbus/sdkconfig.defaults
```kconfig
# Tutorial 0030 defaults (ESP-IDF 5.4.x)
#
# Reproducible, board-appropriate defaults for Cardputer.
#

# Flash size: Cardputer is commonly 8MB.
CONFIG_ESPTOOLPY_FLASHSIZE_8MB=y
CONFIG_ESPTOOLPY_FLASHSIZE="8MB"

# Partition table: project-local partitions.csv (factory 4M + storage 1M).
CONFIG_PARTITION_TABLE_CUSTOM=y
CONFIG_PARTITION_TABLE_CUSTOM_FILENAME="partitions.csv"
CONFIG_PARTITION_TABLE_FILENAME="partitions.csv"

# CPU frequency: Cardputer demos usually run at 240MHz.
CONFIG_ESP_DEFAULT_CPU_FREQ_MHZ_240=y
CONFIG_ESP_DEFAULT_CPU_FREQ_MHZ=240

# Main task stack: C++ + M5GFX + console can be stack-hungry.
CONFIG_ESP_MAIN_TASK_STACK_SIZE=8000

# Prefer USB Serial/JTAG for the interactive console on Cardputer.
CONFIG_ESP_CONSOLE_USB_SERIAL_JTAG=y
CONFIG_ESP_CONSOLE_UART_DEFAULT=n
CONFIG_ESP_CONSOLE_UART_CUSTOM=n
CONFIG_ESP_CONSOLE_USB_CDC=n
```

## 0031-zigbee-orchestrator/main/Kconfig.projbuild
```kconfig
menu "Ticket 0031: Zigbee orchestrator (Cardputer host)"

config GW_EVENT_QUEUE_SIZE
    int "GW esp_event queue size"
    range 8 256
    default 64

config GW_MONITOR_MAX_LINES_PER_SEC
    int "Console monitor max lines/sec"
    range 1 1000
    default 50
    help
        Upper bound for the `monitor on` console output rate. When exceeded, monitor
        output is dropped and the drop counter increments.

config GW_CONSOLE_PROMPT
    string "Console prompt"
    default "gw> "

endmenu
```

## 0031-zigbee-orchestrator/sdkconfig.defaults
```kconfig
# Ticket 0031 defaults (ESP-IDF 5.4.x)

CONFIG_ESPTOOLPY_FLASHSIZE_8MB=y
CONFIG_ESPTOOLPY_FLASHSIZE="8MB"

CONFIG_PARTITION_TABLE_CUSTOM=y
CONFIG_PARTITION_TABLE_CUSTOM_FILENAME="partitions.csv"
CONFIG_PARTITION_TABLE_FILENAME="partitions.csv"

CONFIG_ESP_DEFAULT_CPU_FREQ_MHZ_240=y
CONFIG_ESP_DEFAULT_CPU_FREQ_MHZ=240

CONFIG_ESP_MAIN_TASK_STACK_SIZE=8000

# Use USB Serial/JTAG as the primary console channel (Cardputer-friendly).
CONFIG_ESP_CONSOLE_USB_SERIAL_JTAG=y
CONFIG_ESP_CONSOLE_UART_DEFAULT=n
CONFIG_ESP_CONSOLE_UART_CUSTOM=n
CONFIG_ESP_CONSOLE_USB_CDC=n

# 0031 application defaults.
CONFIG_GW_EVENT_QUEUE_SIZE=64
CONFIG_GW_MONITOR_MAX_LINES_PER_SEC=50
CONFIG_GW_CONSOLE_PROMPT="gw> "

# Zigbee host+NCP link (Unit Gateway H2 via Cardputer Grove UART pins).
# Wiring:
#   H2 TX -> Cardputer G1 (GPIO1)  [host RX]
#   H2 RX -> Cardputer G2 (GPIO2)  [host TX]
CONFIG_HOST_BUS_MODE_UART=y
CONFIG_HOST_BUS_UART_NUM=1
CONFIG_HOST_BUS_UART_RX_PIN=1
CONFIG_HOST_BUS_UART_TX_PIN=2
CONFIG_HOST_BUS_UART_BAUD_RATE=115200
```

## 0036-cardputer-adv-led-matrix-console/sdkconfig.defaults
```kconfig
# Tutorial 0036 defaults (ESP-IDF 5.4.x)
#
# Reproducible defaults for Cardputer-ADV-style bring-up.
#

# Flash size: Cardputer/ADV is commonly 8MB.
CONFIG_ESPTOOLPY_FLASHSIZE_8MB=y
CONFIG_ESPTOOLPY_FLASHSIZE="8MB"

# Partition table: project-local partitions.csv (factory 4M + storage 1M).
CONFIG_PARTITION_TABLE_CUSTOM=y
CONFIG_PARTITION_TABLE_CUSTOM_FILENAME="partitions.csv"
CONFIG_PARTITION_TABLE_FILENAME="partitions.csv"

# CPU frequency: common default for Cardputer demos.
CONFIG_ESP_DEFAULT_CPU_FREQ_MHZ_240=y
CONFIG_ESP_DEFAULT_CPU_FREQ_MHZ=240

# Prefer USB Serial/JTAG for the interactive console on Cardputer/ADV.
CONFIG_ESP_CONSOLE_USB_SERIAL_JTAG=y
CONFIG_ESP_CONSOLE_UART_DEFAULT=n
CONFIG_ESP_CONSOLE_UART_CUSTOM=n
CONFIG_ESP_CONSOLE_USB_CDC=n
```

## 0038-cardputer-adv-serial-terminal/main/Kconfig.projbuild
```kconfig
menu "Tutorial 0038: Cardputer-ADV Serial Terminal"

config TUTORIAL_0038_PRESENT_WAIT_DMA
    bool "Wait for DMA completion after present (avoid tearing)"
    default y

config TUTORIAL_0038_CANVAS_USE_PSRAM
    bool "Allocate M5Canvas sprite in PSRAM (disable for DMA)"
    default n

config TUTORIAL_0038_MAX_LINES
    int "Maximum stored lines in buffer"
    range 16 4096
    default 256

choice
    prompt "Serial backend"
    default TUTORIAL_0038_BACKEND_UART

config TUTORIAL_0038_BACKEND_USB_SERIAL_JTAG
    bool "USB (USB-Serial-JTAG / ttyACM*)"

config TUTORIAL_0038_BACKEND_UART
    bool "GROVE UART (G1/G2)"
endchoice

config TUTORIAL_0038_UART_NUM
    int "UART port number (controller)"
    range 0 2
    default 1
    depends on TUTORIAL_0038_BACKEND_UART

config TUTORIAL_0038_UART_BAUD
    int "GROVE UART baud rate"
    range 1200 3000000
    default 115200
    depends on TUTORIAL_0038_BACKEND_UART

config TUTORIAL_0038_UART_TX_GPIO
    int "GROVE UART TX GPIO (default: G2)"
    range 0 48
    default 2
    depends on TUTORIAL_0038_BACKEND_UART

config TUTORIAL_0038_UART_RX_GPIO
    int "GROVE UART RX GPIO (default: G1)"
    range 0 48
    default 1
    depends on TUTORIAL_0038_BACKEND_UART

config TUTORIAL_0038_LOCAL_ECHO
    bool "Local echo typed bytes to screen"
    default y

config TUTORIAL_0038_SHOW_RX
    bool "Show incoming bytes on screen"
    default y

config TUTORIAL_0038_NEWLINE_CRLF
    bool "Transmit CRLF on Enter"
    default y

choice
    prompt "Backspace transmit byte"
    default TUTORIAL_0038_BS_SEND_DEL

config TUTORIAL_0038_BS_SEND_BS
    bool "0x08 (BS)"

config TUTORIAL_0038_BS_SEND_DEL
    bool "0x7f (DEL)"
endchoice

config TUTORIAL_0038_LOG_KEY_EVENTS
    bool "Debug: log every key event"
    default n

config TUTORIAL_0038_RELAY_ENABLE
    bool "Enable local relay control (GPIO)"
    default y

config TUTORIAL_0038_RELAY_GPIO
    int "Relay GPIO (default: 3)"
    range 0 48
    default 3
    depends on TUTORIAL_0038_RELAY_ENABLE

config TUTORIAL_0038_RELAY_ACTIVE_HIGH
    bool "Relay polarity active-high (default: active-low)"
    default n
    depends on TUTORIAL_0038_RELAY_ENABLE

endmenu
```

## 0038-cardputer-adv-serial-terminal/sdkconfig.defaults
```kconfig
# Tutorial 0038 defaults (ESP-IDF 5.4.1)
#
# Reproducible, board-appropriate defaults for Cardputer + ADV keyboard.
#

# Flash size: Cardputer is commonly 8MB.
CONFIG_ESPTOOLPY_FLASHSIZE_8MB=y
CONFIG_ESPTOOLPY_FLASHSIZE="8MB"

# Partition table: project-local partitions.csv (factory 4M + storage 1M).
CONFIG_PARTITION_TABLE_CUSTOM=y
CONFIG_PARTITION_TABLE_CUSTOM_FILENAME="partitions.csv"
CONFIG_PARTITION_TABLE_FILENAME="partitions.csv"

# CPU frequency: Cardputer demos usually run at 240MHz.
CONFIG_ESP_DEFAULT_CPU_FREQ_MHZ_240=y
CONFIG_ESP_DEFAULT_CPU_FREQ_MHZ=240

# Main task stack: M5GFX is C++ and can be stack-hungry.
CONFIG_ESP_MAIN_TASK_STACK_SIZE=8000

# Prefer USB Serial/JTAG for any console/REPL work on Cardputer/ADV.
CONFIG_ESP_CONSOLE_USB_SERIAL_JTAG=y
CONFIG_ESP_CONSOLE_UART_DEFAULT=n
CONFIG_ESP_CONSOLE_UART_CUSTOM=n
CONFIG_ESP_CONSOLE_USB_CDC=n

# Tutorial defaults:
CONFIG_TUTORIAL_0038_PRESENT_WAIT_DMA=y
CONFIG_TUTORIAL_0038_CANVAS_USE_PSRAM=n
CONFIG_TUTORIAL_0038_MAX_LINES=256

# Serial backend defaults:
# Default to UART so the USB Serial/JTAG transport is reserved for `esp_console`.
CONFIG_TUTORIAL_0038_BACKEND_UART=y
CONFIG_TUTORIAL_0038_LOCAL_ECHO=y
CONFIG_TUTORIAL_0038_SHOW_RX=y
CONFIG_TUTORIAL_0038_NEWLINE_CRLF=y
CONFIG_TUTORIAL_0038_BS_SEND_DEL=y

# UART defaults (only used when UART backend is selected):
CONFIG_TUTORIAL_0038_UART_NUM=1
CONFIG_TUTORIAL_0038_UART_BAUD=115200
CONFIG_TUTORIAL_0038_UART_TX_GPIO=2
CONFIG_TUTORIAL_0038_UART_RX_GPIO=1

# Debug:
CONFIG_TUTORIAL_0038_LOG_KEY_EVENTS=n

# Relay control (GPIO3 is active-low by default):
CONFIG_TUTORIAL_0038_RELAY_ENABLE=y
CONFIG_TUTORIAL_0038_RELAY_GPIO=3
CONFIG_TUTORIAL_0038_RELAY_ACTIVE_HIGH=n
```
