## 0039-cardputer-adv-js-gpio-exercizer/sdkconfig.defaults
```kconfig
#
# Cardputer-oriented defaults (ESP32-S3)
#
# Keep this file free of secrets (WiFi creds, tokens, etc).
#

# Cardputer commonly ships with 8MB flash
CONFIG_ESPTOOLPY_FLASHSIZE_8MB=y
CONFIG_ESPTOOLPY_FLASHSIZE="8MB"

# Partition table: project-local partitions.csv (factory 4M + storage 1M).
CONFIG_PARTITION_TABLE_CUSTOM=y
CONFIG_PARTITION_TABLE_CUSTOM_FILENAME="partitions.csv"
CONFIG_PARTITION_TABLE_FILENAME="partitions.csv"

# Cardputer: run CPU at 240MHz
CONFIG_ESP_DEFAULT_CPU_FREQ_MHZ_240=y
CONFIG_ESP_DEFAULT_CPU_FREQ_MHZ=240

# Give app_main a bit more headroom
CONFIG_ESP_MAIN_TASK_STACK_SIZE=8000
```

## 0040-atoms3r-cam-streaming/esp32-camera-stream/firmware/main/Kconfig.projbuild
```kconfig
menu "AtomS3R Camera Stream"

    config CAMERA_XCLK_FREQ
        int "XCLK frequency"
        range 1000000 40000000
        default 20000000
        help
            Select XCLK frequency.

    menu "Camera Pin Configuration"

        choice CAMERA_MODULE
            bool "Select Camera Pinout"
            default CAMERA_MODULE_M5STACK_ATOMS3R_CAM if IDF_TARGET_ESP32S3
            default CAMERA_MODULE_ESP_S2_KALUGA if IDF_TARGET_ESP32S2
            help
                Select Camera Pinout.

            config CAMERA_MODULE_ESP_S2_KALUGA
                bool "ESP32-S2-Kaluga-1 V1.3"
            config CAMERA_MODULE_ESP_S3_EYE
                bool "ESP-S3-EYE DevKit"
            config CAMERA_MODULE_ESP_S3_KORVO2
                bool "ESP-S3-Korvo-2"
            config CAMERA_MODULE_M5STACK_ATOMS3R_CAM
                bool "M5Stack-AtomS3R-CAM"
            config CAMERA_MODULE_CUSTOM
                bool "Custom Camera Pinout"
        endchoice

        config CAMERA_PIN_PWDN
            depends on CAMERA_MODULE_CUSTOM
            int "Power Down pin"
            range -1 33
            default -1
            help
                Select Power Down pin or -1 for unmanaged.

        config CAMERA_PIN_RESET
            depends on CAMERA_MODULE_CUSTOM
            int "Reset pin"
            range -1 33
            default -1
            help
                Select Camera Reset pin or -1 for software reset.

        config CAMERA_PIN_XCLK
            depends on CAMERA_MODULE_CUSTOM
            int "XCLK pin"
            range 0 33
            default 21
            help
                Select Camera XCLK pin.

        config CAMERA_PIN_SIOD
            depends on CAMERA_MODULE_CUSTOM
            int "SIOD pin"
            range 0 33
            default 26
            help
                Select Camera SIOD pin.

        config CAMERA_PIN_SIOC
            depends on CAMERA_MODULE_CUSTOM
            int "SIOC pin"
            range 0 33
            default 27
            help
                Select Camera SIOC pin.

        config CAMERA_PIN_VSYNC
            depends on CAMERA_MODULE_CUSTOM
            int "VSYNC pin"
            range 0 39
            default 25
            help
                Select Camera VSYNC pin.

        config CAMERA_PIN_HREF
            depends on CAMERA_MODULE_CUSTOM
            int "HREF pin"
            range 0 39
            default 23
            help
                Select Camera HREF pin.

        config CAMERA_PIN_PCLK
            depends on CAMERA_MODULE_CUSTOM
            int "PCLK pin"
            range 0 39
            default 25
            help
                Select Camera PCLK pin.

        config CAMERA_PIN_Y2
            depends on CAMERA_MODULE_CUSTOM
            int "Y2 pin"
            range 0 39
            default 4
            help
                Select Camera Y2 pin.

        config CAMERA_PIN_Y3
            depends on CAMERA_MODULE_CUSTOM
            int "Y3 pin"
            range 0 39
            default 5
            help
                Select Camera Y3 pin.

        config CAMERA_PIN_Y4
            depends on CAMERA_MODULE_CUSTOM
            int "Y4 pin"
            range 0 39
            default 18
            help
                Select Camera Y4 pin.

        config CAMERA_PIN_Y5
            depends on CAMERA_MODULE_CUSTOM
            int "Y5 pin"
            range 0 39
            default 19
            help
                Select Camera Y5 pin.

        config CAMERA_PIN_Y6
            depends on CAMERA_MODULE_CUSTOM
            int "Y6 pin"
            range 0 39
            default 36
            help
                Select Camera Y6 pin.

        config CAMERA_PIN_Y7
            depends on CAMERA_MODULE_CUSTOM
            int "Y7 pin"
            range 0 39
            default 39
            help
                Select Camera Y7 pin.

        config CAMERA_PIN_Y8
            depends on CAMERA_MODULE_CUSTOM
            int "Y8 pin"
            range 0 39
            default 34
            help
                Select Camera Y8 pin.

        config CAMERA_PIN_Y9
            depends on CAMERA_MODULE_CUSTOM
            int "Y9 pin"
            range 0 39
            default 35
            help
                Select Camera Y9 pin.
    endmenu

    menu "Camera Component Options"

        choice SCCB_HARDWARE_I2C_PORT
            bool "I2C peripheral to use for SCCB"
            default SCCB_HARDWARE_I2C_PORT1

            config SCCB_HARDWARE_I2C_PORT0
                bool "I2C0"
            config SCCB_HARDWARE_I2C_PORT1
                bool "I2C1"

        endchoice

        config SCCB_CLK_FREQ
            int "SCCB clk frequency"
            default 100000
            range 100000 400000
            help
                Increasing this value can reduce the initialization time of the sensor.
                Please refer to the relevant instructions of the sensor to adjust the value.

        config CAMERA_TASK_STACK_SIZE
            int "CAM task stack size"
            default 2048
            help
                Camera task stack size.

        choice CAMERA_TASK_PINNED_TO_CORE
            bool "Camera task pinned to core"
            default CAMERA_CORE0
            help
                Pin the camera handle task to a certain core(0/1). It can also be done automatically choosing NO_AFFINITY.

            config CAMERA_CORE0
                bool "CORE0"
            config CAMERA_CORE1
                bool "CORE1"
            config CAMERA_NO_AFFINITY
                bool "NO_AFFINITY"

        endchoice

        config CAMERA_DMA_BUFFER_SIZE_MAX
            int "DMA buffer size"
            range 8192 32768
            default 32768
            help
                Maximum value of DMA buffer.
                Larger values may fail to allocate due to insufficient contiguous memory blocks, and smaller values may cause DMA interrupt to be too frequent.

        choice CAMERA_JPEG_MODE_FRAME_SIZE_OPTION
            prompt "JPEG mode frame size option"
            default CAMERA_JPEG_MODE_FRAME_SIZE_AUTO
            help
                Select whether to use automatic calculation for JPEG mode frame size or specify a custom value.

            config CAMERA_JPEG_MODE_FRAME_SIZE_AUTO
                bool "Use automatic calculation (width * height / 5)"
                help
                    Use the default calculation for JPEG mode frame size.
                    Note: In very low resolutions like QQVGA, the default calculation tends to result in insufficient buffer size.

            config CAMERA_JPEG_MODE_FRAME_SIZE_CUSTOM
                bool "Specify custom frame size"
                help
                    Specify a custom frame size in bytes for JPEG mode.

        endchoice

        config CAMERA_JPEG_MODE_FRAME_SIZE
            int "Custom JPEG mode frame size (bytes)"
            default 8192
            depends on CAMERA_JPEG_MODE_FRAME_SIZE_CUSTOM
            help
                This option sets the custom frame size in JPEG mode.
                Specify the desired buffer size in bytes.

    endmenu

    config ATOMS3R_CAMERA_POWER_ACTIVE_LOW
        bool "Camera power GPIO is active low"
        default y
        help
            When enabled, cam power 1 drives the GPIO low (matches the demo's
            pulldown-only enable behavior).

    config ATOMS3R_STREAM_HOST
        string "Default stream host"
        default ""
        help
            Optional default host/IP for the WebSocket camera endpoint.
            Leave empty and configure at runtime via the console.

    config ATOMS3R_STREAM_PORT
        int "Default stream port"
        range 1 65535
        default 8080
        help
            Default TCP port for ws://<host>:<port>/ws/camera.

    config ATOMS3R_STREAM_INTERVAL_MS
        int "Frame interval (ms)"
        range 10 1000
        default 66
        help
            Delay between frames (approx 15 fps at 66 ms).

    config ATOMS3R_SENSOR_JPEG_QUALITY
        int "Sensor JPEG quality (lower is higher quality)"
        range 4 63
        default 14
        help
            JPEG quality used by the camera sensor when PIXFORMAT_JPEG is active.

    config ATOMS3R_CONVERT_JPEG_QUALITY
        int "RGB->JPEG conversion quality (higher is higher quality)"
        range 10 100
        default 80
        help
            JPEG quality passed to frame2jpg when converting RGB565 frames.

endmenu
```

## 0040-atoms3r-cam-streaming/esp32-camera-stream/firmware/sdkconfig.defaults
```kconfig
# AtomS3R camera streaming firmware defaults.
CONFIG_IDF_TARGET_ESP32S3=y

# Console: USB Serial/JTAG (keep UART free).
CONFIG_ESP_CONSOLE_USB_SERIAL_JTAG=y
# CONFIG_ESP_CONSOLE_UART is not set
CONFIG_ESP_CONSOLE_SECONDARY_NONE=y

# PSRAM (match ATOMS3R-CAM demo).
CONFIG_SPIRAM=y
CONFIG_SPIRAM_MODE_OCT=y
CONFIG_SPIRAM_TYPE_AUTO=y
CONFIG_SPIRAM_CLK_IO=30
CONFIG_SPIRAM_CS_IO=26
CONFIG_SPIRAM_SPEED_80M=y
CONFIG_SPIRAM_BOOT_INIT=y
CONFIG_SPIRAM_USE_MALLOC=y
CONFIG_SPIRAM_MEMTEST=y
CONFIG_SPIRAM_ALLOW_STACK_EXTERNAL_MEMORY=y
CONFIG_SPIRAM_MALLOC_ALWAYSINTERNAL=6384
CONFIG_SPIRAM_MALLOC_RESERVE_INTERNAL=32768

# Camera (match ATOMS3R-CAM demo).
CONFIG_CAMERA_MODULE_M5STACK_ATOMS3R_CAM=y
CONFIG_CAMERA_XCLK_FREQ=20000000
CONFIG_CAMERA_CONVERTER_ENABLED=y
CONFIG_SCCB_HARDWARE_I2C_PORT1=y
CONFIG_SCCB_CLK_FREQ=100000
CONFIG_CAMERA_TASK_STACK_SIZE=2048
CONFIG_CAMERA_CORE0=y
# CONFIG_CAMERA_CORE1 is not set
# CONFIG_CAMERA_NO_AFFINITY is not set
CONFIG_CAMERA_DMA_BUFFER_SIZE_MAX=32768
CONFIG_CAMERA_JPEG_MODE_FRAME_SIZE_AUTO=y
# CONFIG_CAMERA_JPEG_MODE_FRAME_SIZE_CUSTOM is not set
CONFIG_ATOMS3R_CAMERA_POWER_ACTIVE_LOW=y

# Stream defaults.
CONFIG_ATOMS3R_SENSOR_JPEG_QUALITY=14
CONFIG_ATOMS3R_CONVERT_JPEG_QUALITY=80

# Room for camera/websocket tasks.
CONFIG_ESP_MAIN_TASK_STACK_SIZE=8192

# Logs.
CONFIG_LOG_DEFAULT_LEVEL_INFO=y
```

## 0041-atoms3r-cam-jtag-serial-test/sdkconfig.defaults
```kconfig
CONFIG_ESP_CONSOLE_USB_SERIAL_JTAG=y
# CONFIG_ESP_CONSOLE_UART is not set
CONFIG_ESP_CONSOLE_SECONDARY_NONE=y
CONFIG_ESP_CONSOLE_USB_SERIAL_JTAG_ENABLED=y
CONFIG_ESP_CONSOLE_UART_NUM=-1

CONFIG_SPIRAM=y
CONFIG_SPIRAM_MODE_OCT=y
CONFIG_SPIRAM_TYPE_AUTO=y
CONFIG_SPIRAM_ALLOW_STACK_EXTERNAL_MEMORY=y
CONFIG_SPIRAM_CLK_IO=30
CONFIG_SPIRAM_CS_IO=26
CONFIG_SPIRAM_SPEED_80M=y
CONFIG_SPIRAM_SPEED=80
CONFIG_SPIRAM_BOOT_INIT=y
CONFIG_SPIRAM_USE_MALLOC=y
CONFIG_SPIRAM_MEMTEST=y
CONFIG_SPIRAM_MALLOC_ALWAYSINTERNAL=6384
CONFIG_SPIRAM_MALLOC_RESERVE_INTERNAL=32768

CONFIG_CAMERA_XCLK_FREQ=20000000
CONFIG_CAMERA_MODULE_M5STACK_ATOMS3R_CAM=y

CONFIG_SCCB_HARDWARE_I2C_PORT1=y
CONFIG_SCCB_CLK_FREQ=100000
CONFIG_CAMERA_TASK_STACK_SIZE=2048
CONFIG_CAMERA_CORE0=y
CONFIG_CAMERA_DMA_BUFFER_SIZE_MAX=32768
CONFIG_CAMERA_JPEG_MODE_FRAME_SIZE_AUTO=y

CONFIG_ATOMS3R_CAMERA_POWER_GPIO=18
CONFIG_ATOMS3R_CAMERA_POWER_ACTIVE_LOW=y
```

## 0042-xiao-esp32c6-d0-gpio-toggle/main/Kconfig.projbuild
```kconfig
menu "MO-030: ESP32-C6 D0 GPIO toggle"

config MO030_TOGGLE_GPIO_NUM
    int "GPIO number to toggle"
    range 0 48
    default 0
    help
        GPIO number to toggle.

        Default is 0, which matches the Seeed XIAO ESP32C6 pin map:
        D0 = GPIO0.

config MO030_TOGGLE_ACTIVE_LOW
    bool "Active-low output (invert levels)"
    default n
    help
        If enabled, the pin level is inverted (useful for active-low LEDs).

config MO030_TOGGLE_PERIOD_MS
    int "Toggle period (ms)"
    range 10 60000
    default 500
    help
        Delay between toggles.

endmenu
```

## 0043-xiao-esp32c6-ws2811-4led-d1/main/Kconfig.projbuild
```kconfig
menu "MO-031: WS2811 (RMT) test"

config MO031_WS281X_GPIO_NUM
    int "Data GPIO (XIAO D1 default)"
    range 0 48
    default 1
    help
        Data output GPIO used to drive the strip.

        For Seeed XIAO ESP32C6, D1 maps to GPIO1.

config MO031_WS281X_LED_COUNT
    int "LED count"
    range 1 1024
    default 10
    help
        Number of addressable LEDs in the chain.

config MO031_WS281X_BRIGHTNESS_PCT
    int "Brightness (%)"
    range 1 100
    default 25
    help
        Simple brightness scaler applied to RGB values before sending.

config MO031_INTENSITY_MIN_PCT
    int "Intensity min (%)"
    range 1 100
    default 5
    help
        Minimum intensity when modulation is enabled.

config MO031_INTENSITY_PERIOD_MS
    int "Intensity period (ms)"
    range 100 60000
    default 2500
    help
        Period of the intensity modulation waveform.

config MO031_ANIM_FRAME_MS
    int "Animation frame time (ms)"
    range 1 1000
    default 16
    help
        Delay between frames. Lower is smoother but uses more CPU.

config MO031_RAINBOW_SPEED
    int "Rainbow speed (1-10)"
    range 1 10
    default 5
    help
        Speed of the rainbow rotation. Higher is faster.

config MO031_RAINBOW_SATURATION
    int "Rainbow saturation (0-100)"
    range 0 100
    default 100
    help
        Color saturation. 0 yields white/gray.

config MO031_RAINBOW_SPREAD_X10
    int "Rainbow spread (x10)"
    range 1 50
    default 10
    help
        Controls how much hue range is distributed across the strip.
        10 means 1.0x (full 360 degrees across the strip).

config MO031_WS281X_T0H_NS
    int "T0H (ns)"
    range 50 2000
    default 350
    help
        High time for a logical 0 bit.

config MO031_WS281X_T0L_NS
    int "T0L (ns)"
    range 50 2000
    default 800
    help
        Low time for a logical 0 bit.

config MO031_WS281X_T1H_NS
    int "T1H (ns)"
    range 50 2000
    default 700
    help
        High time for a logical 1 bit.

config MO031_WS281X_T1L_NS
    int "T1L (ns)"
    range 50 2000
    default 600
    help
        Low time for a logical 1 bit.

config MO031_WS281X_RESET_US
    int "Reset time (us)"
    range 10 500
    default 80
    help
        Low reset time after sending a frame.

endmenu
```

## 0045-xiao-esp32c6-preact-web/main/Kconfig.projbuild
```kconfig
menu "MO-033: ESP32-C6 Preact Web"

config MO033_WIFI_MAX_RETRY
    int "Wi-Fi max retries"
    range 0 100
    default 10
    help
        Maximum number of retries after a STA disconnect when autoconnect is enabled.

config MO033_WIFI_AUTOCONNECT_ON_BOOT
    bool "Autoconnect on boot when credentials exist"
    default y
    help
        If enabled, and runtime credentials are present at STA start (e.g. loaded from NVS),
        the device will attempt to connect automatically.

config MO033_HTTP_CACHE_NO_STORE
    bool "Serve Cache-Control: no-store for static assets"
    default y
    help
        Deterministic asset filenames can cause confusing browser caching during development.
        If enabled, static asset handlers add Cache-Control: no-store.

endmenu
```

## 0045-xiao-esp32c6-preact-web/sdkconfig.defaults
```kconfig
CONFIG_ESP_CONSOLE_USB_SERIAL_JTAG=y
# CONFIG_ESP_CONSOLE_UART is not set
CONFIG_ESP_CONSOLE_SECONDARY_NONE=y
CONFIG_ESP_CONSOLE_USB_SERIAL_JTAG_ENABLED=y
CONFIG_ESP_CONSOLE_UART_NUM=-1

# Keep console usable (avoid overwhelming logs).
CONFIG_LOG_DEFAULT_LEVEL_INFO=y
```
