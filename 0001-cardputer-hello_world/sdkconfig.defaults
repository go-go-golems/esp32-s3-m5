## 0014-atoms3r-animatedgif-single/main/Kconfig.projbuild
```kconfig
menu "Tutorial 0014: AtomS3R AnimatedGIF Single (GC9107 via M5GFX / LovyanGFX)"

config TUTORIAL_0014_LCD_HRES
    int "Horizontal resolution"
    range 1 1024
    default 128

config TUTORIAL_0014_LCD_VRES
    int "Vertical resolution"
    range 1 1024
    default 128

config TUTORIAL_0014_LCD_X_OFFSET
    int "X offset (panel RAM window)"
    range 0 64
    default 0

config TUTORIAL_0014_LCD_Y_OFFSET
    int "Y offset (panel RAM window)"
    range 0 64
    default 32
    help
        AtomS3R GC9107 uses 128x160 internal RAM; the visible 128x128 window typically sits at y-offset 32.

config TUTORIAL_0014_LCD_INVERT
    bool "Invert colors"
    default n

config TUTORIAL_0014_LCD_RGB_ORDER_RGB
    bool "RGB order (disable for BGR)"
    default n
    help
        In M5GFX/LovyanGFX panel config, rgb_order=true means RGB, rgb_order=false means BGR.

config TUTORIAL_0014_LCD_SPI_PCLK_HZ
    int "SPI pixel clock (Hz)"
    range 1000000 80000000
    default 40000000

endmenu

menu "Tutorial 0014: Canvas / Present"

config TUTORIAL_0014_CANVAS_USE_PSRAM
    bool "Allocate M5Canvas sprite in PSRAM (disable for DMA)"
    default n
    help
        When disabled, LovyanGFX allocates sprite buffers using AllocationSource::Dma,
        which is DMA-capable and safest for full-frame updates.

config TUTORIAL_0014_PRESENT_USE_DMA
    bool "Present frames using SPI DMA (pushImageDMA + waitDMA)"
    default y
    help
        When enabled, each frame is pushed via DMA and we explicitly wait for completion
        before rendering the next frame, to avoid frame-rate "flutter".

endmenu

menu "Tutorial 0014: GIF Render"

config TUTORIAL_0014_GIF_SWAP_BYTES
    bool "Swap bytes of RGB565 pixels produced by AnimatedGIF"
    default y
    help
        AnimatedGIF can generate RGB565 palette entries in a byte-swapped (MSB-first) form.
        If colors look "wrong" (e.g. greens appear purple), enable this to byte-swap pixels
        before writing them into the M5Canvas buffer.

config TUTORIAL_0014_GIF_SCALE_TO_FULL_SCREEN
    bool "Scale GIF canvas to fill the 128x128 screen (nearest-neighbor)"
    default y
    help
        Scales the decoded GIF canvas to the full AtomS3R visible area using nearest-neighbor.
        This is primarily a harness/debug feature (use native 128x128 assets for final playback).

endmenu

menu "Tutorial 0014: Backlight"

config TUTORIAL_0014_BACKLIGHT_GATE_ENABLE
    bool "Drive backlight gate GPIO"
    default y

config TUTORIAL_0014_BACKLIGHT_GATE_GPIO
    int "Backlight gate GPIO"
    range 0 48
    default 7
    depends on TUTORIAL_0014_BACKLIGHT_GATE_ENABLE

config TUTORIAL_0014_BACKLIGHT_GATE_ACTIVE_LOW
    bool "Backlight gate is active-low"
    default y
    depends on TUTORIAL_0014_BACKLIGHT_GATE_ENABLE

config TUTORIAL_0014_BACKLIGHT_I2C_ENABLE
    bool "Use I2C brightness device"
    default y

config TUTORIAL_0014_BL_I2C_SCL_GPIO
    int "Backlight I2C SCL GPIO"
    range 0 48
    default 0
    depends on TUTORIAL_0014_BACKLIGHT_I2C_ENABLE

config TUTORIAL_0014_BL_I2C_SDA_GPIO
    int "Backlight I2C SDA GPIO"
    range 0 48
    default 45
    depends on TUTORIAL_0014_BACKLIGHT_I2C_ENABLE

config TUTORIAL_0014_BL_I2C_ADDR
    hex "Backlight I2C address"
    default 0x30
    depends on TUTORIAL_0014_BACKLIGHT_I2C_ENABLE

config TUTORIAL_0014_BL_I2C_REG
    hex "Backlight brightness register"
    default 0x0e
    depends on TUTORIAL_0014_BACKLIGHT_I2C_ENABLE

config TUTORIAL_0014_BL_BRIGHTNESS_ON
    int "Backlight brightness (0..255)"
    range 0 255
    default 255
    depends on TUTORIAL_0014_BACKLIGHT_I2C_ENABLE

endmenu

menu "Tutorial 0014: Debug Logging"

config TUTORIAL_0014_LOG_EVERY_N_FRAMES
    int "Log heartbeat every N frames (0=disabled)"
    range 0 10000
    default 60

endmenu
```

## 0014-atoms3r-animatedgif-single/sdkconfig.defaults
```kconfig
# Tutorial 0014 defaults (ESP-IDF 5.4.1)
#
# Reproducible, board-appropriate defaults for AtomS3R.
#

# Flash size: AtomS3R is commonly 8MB.
CONFIG_ESPTOOLPY_FLASHSIZE_8MB=y
CONFIG_ESPTOOLPY_FLASHSIZE="8MB"

# Partition table: project-local partitions.csv (factory 4M + storage 1M).
CONFIG_PARTITION_TABLE_CUSTOM=y
CONFIG_PARTITION_TABLE_CUSTOM_FILENAME="partitions.csv"
CONFIG_PARTITION_TABLE_FILENAME="partitions.csv"

# CPU frequency: AtomS3(R) demos usually run at 240MHz.
CONFIG_ESP_DEFAULT_CPU_FREQ_MHZ_240=y
CONFIG_ESP_DEFAULT_CPU_FREQ_MHZ=240

# Main task stack: M5GFX is C++ and can be stack-hungry.
CONFIG_ESP_MAIN_TASK_STACK_SIZE=8000

# Tutorial defaults (match known-good bring-up from tutorial 0010):
CONFIG_TUTORIAL_0014_LCD_Y_OFFSET=32
CONFIG_TUTORIAL_0014_LCD_SPI_PCLK_HZ=40000000
CONFIG_TUTORIAL_0014_CANVAS_USE_PSRAM=n
CONFIG_TUTORIAL_0014_PRESENT_USE_DMA=y
CONFIG_TUTORIAL_0014_BACKLIGHT_GATE_ENABLE=y
CONFIG_TUTORIAL_0014_BACKLIGHT_GATE_GPIO=7
CONFIG_TUTORIAL_0014_BACKLIGHT_GATE_ACTIVE_LOW=y
CONFIG_TUTORIAL_0014_BACKLIGHT_I2C_ENABLE=y
CONFIG_TUTORIAL_0014_BL_I2C_SCL_GPIO=0
CONFIG_TUTORIAL_0014_BL_I2C_SDA_GPIO=45
CONFIG_TUTORIAL_0014_BL_I2C_ADDR=0x30
CONFIG_TUTORIAL_0014_BL_I2C_REG=0x0e
CONFIG_TUTORIAL_0014_BL_BRIGHTNESS_ON=255
CONFIG_TUTORIAL_0014_LOG_EVERY_N_FRAMES=60

# GIF render harness defaults:
CONFIG_TUTORIAL_0014_GIF_USE_COOKED=y
CONFIG_TUTORIAL_0014_GIF_SWAP_BYTES=y
CONFIG_TUTORIAL_0014_GIF_SCALE_TO_FULL_SCREEN=y
```

## 0015-cardputer-serial-terminal/main/Kconfig.projbuild
```kconfig
menu "Tutorial 0015: Cardputer Serial Terminal"

config TUTORIAL_0015_PRESENT_WAIT_DMA
    bool "Wait for DMA completion after present (avoid tearing)"
    default y
    help
        When enabled, each present is followed by display.waitDMA() so we don't
        start rendering into a buffer that is still being transferred.

config TUTORIAL_0015_CANVAS_USE_PSRAM
    bool "Allocate M5Canvas sprite in PSRAM (disable for DMA)"
    default n
    help
        When disabled, LovyanGFX allocates sprite buffers using DMA-capable memory,
        which is safest for full-frame updates.

config TUTORIAL_0015_LOG_EVERY_N_EVENTS
    int "Log heartbeat every N edit events (0=disabled)"
    range 0 100000
    default 0

config TUTORIAL_0015_MAX_LINES
    int "Maximum stored lines in buffer"
    range 16 4096
    default 256

choice
    prompt "Serial backend"
    default TUTORIAL_0015_BACKEND_USB_SERIAL_JTAG

config TUTORIAL_0015_BACKEND_USB_SERIAL_JTAG
    bool "USB (USB-Serial-JTAG / ttyACM*)"

config TUTORIAL_0015_BACKEND_UART
    bool "GROVE UART (G1/G2)"
endchoice

config TUTORIAL_0015_UART_NUM
    int "UART port number (controller)"
    range 0 2
    default 1
    depends on TUTORIAL_0015_BACKEND_UART

config TUTORIAL_0015_UART_BAUD
    int "GROVE UART baud rate"
    range 1200 3000000
    default 115200
    depends on TUTORIAL_0015_BACKEND_UART

config TUTORIAL_0015_UART_TX_GPIO
    int "GROVE UART TX GPIO (default: G2)"
    range 0 48
    default 2
    depends on TUTORIAL_0015_BACKEND_UART

config TUTORIAL_0015_UART_RX_GPIO
    int "GROVE UART RX GPIO (default: G1)"
    range 0 48
    default 1
    depends on TUTORIAL_0015_BACKEND_UART
    help
        Cardputer GROVE labels:
        - G1 is typically GPIO1
        - G2 is typically GPIO2

        UART direction is a convention:
        - default in this tutorial: RX=G1 (GPIO1), TX=G2 (GPIO2)

        Note: the Cardputer keyboard scanner has an optional IN0/IN1 autodetect path that may also
        reference GPIO1/GPIO2. If you use GROVE UART on these pins, consider disabling
        `TUTORIAL_0015_AUTODETECT_IN01` to avoid pin conflicts.

config TUTORIAL_0015_LOCAL_ECHO
    bool "Local echo typed bytes to screen"
    default y
    help
        When enabled, keys typed on the Cardputer are immediately applied to the on-screen
        buffer (local echo). If your remote device also echoes, you may want to disable
        this to avoid duplicated characters.

config TUTORIAL_0015_SHOW_RX
    bool "Show incoming bytes on screen"
    default y
    help
        When enabled, bytes received from the configured backend are appended to the on-screen buffer.

config TUTORIAL_0015_NEWLINE_CRLF
    bool "Transmit CRLF on Enter"
    default y
    help
        When enabled, pressing Enter transmits \\r\\n. When disabled, it transmits \\n only.

choice
    prompt "Backspace transmit byte"
    default TUTORIAL_0015_BS_SEND_DEL

config TUTORIAL_0015_BS_SEND_BS
    bool "0x08 (BS)"

config TUTORIAL_0015_BS_SEND_DEL
    bool "0x7f (DEL)"
endchoice

config TUTORIAL_0015_SCAN_PERIOD_MS
    int "Keyboard scan period (ms)"
    range 1 1000
    default 10
    help
        How often to scan the keyboard matrix.

config TUTORIAL_0015_DEBOUNCE_MS
    int "Per-key debounce (ms)"
    range 0 1000
    default 30
    help
        Minimum time between emitting the same key again (per key position).
        This is a simple debounce guardrail.

config TUTORIAL_0015_SCAN_SETTLE_US
    int "Settle delay after changing scan outputs (us)"
    range 0 1000
    default 30
    help
        Small delay after updating the 3 output pins before reading input pins.
        Some boards/wiring benefit from a short settle time.

config TUTORIAL_0015_AUTODETECT_IN01
    bool "Autodetect IN0/IN1 pins (13/15 vs 1/2)"
    default y
    help
        Some Cardputer revisions appear to route keyboard IN0/IN1 to GPIO1/GPIO2 instead of GPIO13/GPIO15.
        When enabled, the firmware will automatically switch to the alternate pin pair if key activity is detected there.

config TUTORIAL_0015_KB_ALT_IN0_GPIO
    int "Alt IN0 GPIO (autodetect)"
    range 0 48
    default 1
    depends on TUTORIAL_0015_AUTODETECT_IN01

config TUTORIAL_0015_KB_ALT_IN1_GPIO
    int "Alt IN1 GPIO (autodetect)"
    range 0 48
    default 2
    depends on TUTORIAL_0015_AUTODETECT_IN01

config TUTORIAL_0015_DEBUG_RAW_SCAN
    bool "Debug: log raw scan masks when keys are detected"
    default n
    help
        When enabled, logs the raw per-scan-state input mask whenever a key press is detected.

config TUTORIAL_0015_LOG_KEY_EVENTS
    bool "Debug: log a line for every key press event"
    default n
    help
        When enabled, prints an ESP_LOGI line for every emitted key press event.

config TUTORIAL_0015_KB_OUT0_GPIO
    int "Keyboard OUT0 GPIO"
    range 0 48
    default 8
    help
        Keyboard scan output pin 0 (Cardputer default: 8).

config TUTORIAL_0015_KB_OUT1_GPIO
    int "Keyboard OUT1 GPIO"
    range 0 48
    default 9
    help
        Keyboard scan output pin 1 (Cardputer default: 9).

config TUTORIAL_0015_KB_OUT2_GPIO
    int "Keyboard OUT2 GPIO"
    range 0 48
    default 11
    help
        Keyboard scan output pin 2 (Cardputer default: 11).

config TUTORIAL_0015_KB_IN0_GPIO
    int "Keyboard IN0 GPIO"
    range 0 48
    default 13
    help
        Keyboard scan input pin 0 (Cardputer default: 13).

config TUTORIAL_0015_KB_IN1_GPIO
    int "Keyboard IN1 GPIO"
    range 0 48
    default 15
    help
        Keyboard scan input pin 1 (Cardputer default: 15).

config TUTORIAL_0015_KB_IN2_GPIO
    int "Keyboard IN2 GPIO"
    range 0 48
    default 3
    help
        Keyboard scan input pin 2 (Cardputer default: 3).

config TUTORIAL_0015_KB_IN3_GPIO
    int "Keyboard IN3 GPIO"
    range 0 48
    default 4
    help
        Keyboard scan input pin 3 (Cardputer default: 4).

config TUTORIAL_0015_KB_IN4_GPIO
    int "Keyboard IN4 GPIO"
    range 0 48
    default 5
    help
        Keyboard scan input pin 4 (Cardputer default: 5).

config TUTORIAL_0015_KB_IN5_GPIO
    int "Keyboard IN5 GPIO"
    range 0 48
    default 6
    help
        Keyboard scan input pin 5 (Cardputer default: 6).

config TUTORIAL_0015_KB_IN6_GPIO
    int "Keyboard IN6 GPIO"
    range 0 48
    default 7
    help
        Keyboard scan input pin 6 (Cardputer default: 7).

endmenu
```

## 0015-cardputer-serial-terminal/sdkconfig.defaults
```kconfig
# Tutorial 0015 defaults (ESP-IDF 5.4.1)
#
# Reproducible, board-appropriate defaults for Cardputer.
#

# Flash size: Cardputer is commonly 8MB.
CONFIG_ESPTOOLPY_FLASHSIZE_8MB=y
CONFIG_ESPTOOLPY_FLASHSIZE="8MB"

# Partition table: project-local partitions.csv (factory 4M + storage 1M).
CONFIG_PARTITION_TABLE_CUSTOM=y
CONFIG_PARTITION_TABLE_CUSTOM_FILENAME="partitions.csv"
CONFIG_PARTITION_TABLE_FILENAME="partitions.csv"

# CPU frequency: Cardputer demos usually run at 240MHz.
CONFIG_ESP_DEFAULT_CPU_FREQ_MHZ_240=y
CONFIG_ESP_DEFAULT_CPU_FREQ_MHZ=240

# Main task stack: M5GFX is C++ and can be stack-hungry.
CONFIG_ESP_MAIN_TASK_STACK_SIZE=8000

# Tutorial defaults:
CONFIG_TUTORIAL_0015_PRESENT_WAIT_DMA=y
CONFIG_TUTORIAL_0015_CANVAS_USE_PSRAM=n
CONFIG_TUTORIAL_0015_LOG_EVERY_N_EVENTS=0
CONFIG_TUTORIAL_0015_MAX_LINES=256

# Serial backend defaults:
CONFIG_TUTORIAL_0015_BACKEND_USB_SERIAL_JTAG=y
CONFIG_TUTORIAL_0015_LOCAL_ECHO=y
CONFIG_TUTORIAL_0015_SHOW_RX=y
CONFIG_TUTORIAL_0015_NEWLINE_CRLF=y
CONFIG_TUTORIAL_0015_BS_SEND_DEL=y

# UART defaults (only used when UART backend is selected):
CONFIG_TUTORIAL_0015_UART_NUM=1
CONFIG_TUTORIAL_0015_UART_BAUD=115200
CONFIG_TUTORIAL_0015_UART_TX_GPIO=2
CONFIG_TUTORIAL_0015_UART_RX_GPIO=1

# Keyboard scan defaults (Cardputer):
CONFIG_TUTORIAL_0015_SCAN_PERIOD_MS=10
CONFIG_TUTORIAL_0015_DEBOUNCE_MS=30
CONFIG_TUTORIAL_0015_SCAN_SETTLE_US=30
CONFIG_TUTORIAL_0015_AUTODETECT_IN01=y
CONFIG_TUTORIAL_0015_KB_ALT_IN0_GPIO=1
CONFIG_TUTORIAL_0015_KB_ALT_IN1_GPIO=2
CONFIG_TUTORIAL_0015_DEBUG_RAW_SCAN=n
CONFIG_TUTORIAL_0015_LOG_KEY_EVENTS=n
CONFIG_TUTORIAL_0015_KB_OUT0_GPIO=8
CONFIG_TUTORIAL_0015_KB_OUT1_GPIO=9
CONFIG_TUTORIAL_0015_KB_OUT2_GPIO=11
CONFIG_TUTORIAL_0015_KB_IN0_GPIO=13
CONFIG_TUTORIAL_0015_KB_IN1_GPIO=15
CONFIG_TUTORIAL_0015_KB_IN2_GPIO=3
CONFIG_TUTORIAL_0015_KB_IN3_GPIO=4
CONFIG_TUTORIAL_0015_KB_IN4_GPIO=5
CONFIG_TUTORIAL_0015_KB_IN5_GPIO=6
CONFIG_TUTORIAL_0015_KB_IN6_GPIO=7
```
