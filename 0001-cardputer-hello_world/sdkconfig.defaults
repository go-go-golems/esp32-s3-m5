## 0020-cardputer-ble-keyboard-host/sdkconfig.defaults
```kconfig
# Tutorial 0020 defaults (ESP-IDF 5.4.1)
#
# BLE HID keyboard host (Central) + esp_console over USB Serial/JTAG.
#

# Use USB Serial/JTAG as the primary console channel.
CONFIG_ESP_CONSOLE_USB_SERIAL_JTAG=y
CONFIG_ESP_CONSOLE_UART_DEFAULT=n
CONFIG_ESP_CONSOLE_UART_CUSTOM=n
CONFIG_ESP_CONSOLE_USB_CDC=n

# Flash size (partition table uses >2MB).
CONFIG_ESPTOOLPY_FLASHSIZE_8MB=y
CONFIG_ESPTOOLPY_FLASHSIZE="8MB"

# Bluetooth / BLE (Bluedroid).
CONFIG_BT_ENABLED=y
CONFIG_BT_BLE_ENABLED=y
CONFIG_BT_BLUEDROID_ENABLED=y
# CONFIG_BT_NIMBLE_ENABLED is not set

# BLE 4.2 feature set (for legacy scan APIs: esp_ble_gap_start_scanning()).
CONFIG_BT_BLE_42_FEATURES_SUPPORTED=y
CONFIG_BT_BLE_50_FEATURES_SUPPORTED=n

# GATT client is required (Central + HID over GATT).
CONFIG_BT_GATTC_ENABLE=y
CONFIG_BT_GATTS_ENABLE=n

# Partitions.
CONFIG_PARTITION_TABLE_CUSTOM=y
CONFIG_PARTITION_TABLE_CUSTOM_FILENAME="partitions.csv"
CONFIG_PARTITION_TABLE_FILENAME="partitions.csv"

# CPU defaults (consistent with other tutorials).
CONFIG_ESP_DEFAULT_CPU_FREQ_MHZ_240=y
CONFIG_ESP_DEFAULT_CPU_FREQ_MHZ=240
```

## 0021-atoms3-memo-website/main/Kconfig.projbuild
```kconfig
menu "Ticket CLINTS-MEMO-WEBSITE (0021): AtomS3 Memo Website"

menu "WiFi (SoftAP)"

config CLINTS_MEMO_WIFI_SOFTAP_SSID
    string "SoftAP SSID"
    default "AtomS3-Memo"

config CLINTS_MEMO_WIFI_SOFTAP_PASSWORD
    string "SoftAP password (empty=open)"
    default ""

config CLINTS_MEMO_WIFI_SOFTAP_CHANNEL
    int "SoftAP channel"
    range 1 13
    default 6

config CLINTS_MEMO_WIFI_SOFTAP_MAX_CONN
    int "SoftAP max connections"
    range 1 10
    default 4

endmenu

menu "WiFi (Station)"

config CLINTS_MEMO_WIFI_STA_ENABLE
    bool "Enable STA (connect to existing WiFi)"
    default y

config CLINTS_MEMO_WIFI_SOFTAP_WITH_STA
    bool "Also run SoftAP while on STA"
    default y
    depends on CLINTS_MEMO_WIFI_STA_ENABLE

config CLINTS_MEMO_WIFI_STA_SSID
    string "STA SSID"
    default ""
    depends on CLINTS_MEMO_WIFI_STA_ENABLE

config CLINTS_MEMO_WIFI_STA_PASSWORD
    string "STA password"
    default ""
    depends on CLINTS_MEMO_WIFI_STA_ENABLE

config CLINTS_MEMO_WIFI_STA_MAX_RETRY
    int "STA max reconnect retries"
    range 0 20
    default 10
    depends on CLINTS_MEMO_WIFI_STA_ENABLE

config CLINTS_MEMO_WIFI_STA_CONNECT_TIMEOUT_MS
    int "STA initial connect wait (ms)"
    range 1000 60000
    default 15000
    depends on CLINTS_MEMO_WIFI_STA_ENABLE

config CLINTS_MEMO_WIFI_QUIET_IDF_LOGS
    bool "Reduce noisy ESP-IDF WiFi logs"
    default y
    depends on CLINTS_MEMO_WIFI_STA_ENABLE

endmenu

menu "HTTP logging"

config CLINTS_MEMO_HTTP_LOG_REQUESTS
    bool "Log HTTP requests (verbose)"
    default n

config CLINTS_MEMO_HTTP_LOG_POLLING
    bool "Log polling endpoints (/status, /waveform)"
    default n
    depends on CLINTS_MEMO_HTTP_LOG_REQUESTS

endmenu

menu "Storage (SPIFFS)"

config CLINTS_MEMO_STORAGE_BASE_PATH
    string "VFS mount base path"
    default "/spiffs"

config CLINTS_MEMO_STORAGE_PARTITION_LABEL
    string "SPIFFS partition label"
    default "storage"

config CLINTS_MEMO_RECORDINGS_DIR
    string "Recordings directory (relative to base path)"
    default "rec"

config CLINTS_MEMO_STORAGE_FORMAT_IF_MOUNT_FAILED
    bool "Format partition if mount failed"
    default y

config CLINTS_MEMO_STORAGE_MAX_OPEN_FILES
    int "Max open files for SPIFFS"
    range 1 32
    default 8

endmenu

menu "Audio (I2S)"

config CLINTS_MEMO_AUDIO_SAMPLE_RATE_HZ
    int "Sample rate (Hz)"
    range 8000 48000
    default 16000

config CLINTS_MEMO_AUDIO_FRAME_SAMPLES
    int "I2S read frame size (samples)"
    range 160 4096
    default 640

choice CLINTS_MEMO_I2S_PORT
    prompt "I2S port"
    default CLINTS_MEMO_I2S_PORT_1
    help
        Select the I2S peripheral instance to use for audio capture.

config CLINTS_MEMO_I2S_PORT_0
    bool "I2S0"

config CLINTS_MEMO_I2S_PORT_1
    bool "I2S1"

endchoice

config CLINTS_MEMO_I2S_BCLK_GPIO
    int "I2S BCLK GPIO"
    range -1 48
    default 8

config CLINTS_MEMO_I2S_WS_GPIO
    int "I2S WS/LRCLK GPIO"
    range -1 48
    default 6

config CLINTS_MEMO_I2S_DOUT_GPIO
    int "I2S DOUT GPIO (-1 disables TX)"
    range -1 48
    default 5

config CLINTS_MEMO_I2S_DIN_GPIO
    int "I2S DIN GPIO"
    range -1 48
    default 7

config CLINTS_MEMO_I2S_MCLK_GPIO
    int "I2S MCLK GPIO (-1 disables)"
    range -1 48
    default -1

config CLINTS_MEMO_I2S_CHANNEL_FMT_ALL_LEFT
    bool "Use I2S_CHANNEL_FMT_ALL_LEFT (EchoBase)"
    default y
    help
        EchoBase+ES8311 requires ALL_LEFT to get correct mono capture.

config CLINTS_MEMO_WAVEFORM_N_POINTS
    int "Waveform points returned by /api/v1/waveform"
    range 32 1024
    default 256

config CLINTS_MEMO_WAVEFORM_WINDOW_MS
    int "Waveform window (ms)"
    range 100 5000
    default 1000

endmenu

menu "Codec (ES8311 over I2C)"

config CLINTS_MEMO_CODEC_ES8311_ENABLE
    bool "Enable ES8311 init (EchoBase)"
    default y

config CLINTS_MEMO_CODEC_I2C_PORT
    int "I2C port (0 or 1)"
    range 0 1
    default 1
    depends on CLINTS_MEMO_CODEC_ES8311_ENABLE

config CLINTS_MEMO_CODEC_I2C_SDA_GPIO
    int "I2C SDA GPIO"
    range -1 48
    default 38
    depends on CLINTS_MEMO_CODEC_ES8311_ENABLE

config CLINTS_MEMO_CODEC_I2C_SCL_GPIO
    int "I2C SCL GPIO"
    range -1 48
    default 39
    depends on CLINTS_MEMO_CODEC_ES8311_ENABLE

config CLINTS_MEMO_CODEC_I2C_FREQ_HZ
    int "I2C frequency (Hz)"
    range 100000 1000000
    default 400000
    depends on CLINTS_MEMO_CODEC_ES8311_ENABLE

endmenu

endmenu
```

## 0021-atoms3-memo-website/sdkconfig.defaults
```kconfig
# 0021 — AtomS3 Memo Website (CLINTS-MEMO-WEBSITE)

# Partition table (needs a data partition for recordings).
CONFIG_PARTITION_TABLE_CUSTOM=y
CONFIG_PARTITION_TABLE_CUSTOM_FILENAME="partitions.csv"

# SPIFFS for recordings storage.
CONFIG_SPIFFS_MAX_PARTITIONS=1
CONFIG_SPIFFS_USE_MAGIC=y
CONFIG_SPIFFS_USE_MAGIC_LENGTH=y
CONFIG_SPIFFS_META_LENGTH=4

# Slightly larger main task stack for HTTP + recorder glue.
CONFIG_ESP_MAIN_TASK_STACK_SIZE=8192
```

## 0022-cardputer-m5gfx-demo-suite/sdkconfig.defaults
```kconfig
# Demo-suite defaults (ESP-IDF 5.4.1)
#
# Reproducible, board-appropriate defaults for Cardputer.
#

# Flash size: Cardputer is commonly 8MB.
CONFIG_ESPTOOLPY_FLASHSIZE_8MB=y
CONFIG_ESPTOOLPY_FLASHSIZE="8MB"

# Partition table: project-local partitions.csv (factory 4M + storage 1M).
CONFIG_PARTITION_TABLE_CUSTOM=y
CONFIG_PARTITION_TABLE_CUSTOM_FILENAME="partitions.csv"
CONFIG_PARTITION_TABLE_FILENAME="partitions.csv"

# CPU frequency: Cardputer demos usually run at 240MHz.
CONFIG_ESP_DEFAULT_CPU_FREQ_MHZ_240=y
CONFIG_ESP_DEFAULT_CPU_FREQ_MHZ=240

# Main task stack: M5GFX is C++ and can be stack-hungry.
CONFIG_ESP_MAIN_TASK_STACK_SIZE=8000
```
