## 0001-cardputer-hello_world/sdkconfig.defaults
```kconfig
# Cardputer tutorial defaults (ESP-IDF 5.4.1)
#
# Why this exists:
# - keep important configuration in version control (reproducible builds)
# - align with Cardputer reality: no PSRAM, larger flash, custom partitions
#

# Flash size (Cardputer project historically used 8MB on ESP-IDF 4.4.6)
# This matters because our `partitions.csv` allocates 4M(app)+1M(storage)+system partitions.
# If you have a different Cardputer flash variant, adjust accordingly via `idf.py menuconfig`.
CONFIG_ESPTOOLPY_FLASHSIZE_8MB=y
CONFIG_ESPTOOLPY_FLASHSIZE="8MB"

# Partition table: use project-local partitions.csv (Cardputer-style layout)
CONFIG_PARTITION_TABLE_CUSTOM=y
# CONFIG_PARTITION_TABLE_SINGLE_APP is not set
CONFIG_PARTITION_TABLE_CUSTOM_FILENAME="partitions.csv"
CONFIG_PARTITION_TABLE_FILENAME="partitions.csv"

# CPU frequency: Cardputer repo config (ESP-IDF 4.4.6) ran at 160MHz by default.
CONFIG_ESP_DEFAULT_CPU_FREQ_MHZ_160=y
CONFIG_ESP_DEFAULT_CPU_FREQ_MHZ=160

# Main task stack: Cardputer repo used 8000 bytes (safer for larger C++ apps).
CONFIG_ESP_MAIN_TASK_STACK_SIZE=8000
```

## 0005-wifi-event-loop/main/Kconfig.projbuild
```kconfig
menu "Tutorial 0005: WiFi + Event Loop"

config TUTORIAL_0005_WIFI_SSID
    string "WiFi SSID"
    default ""
    help
        SSID for WiFi station connection.

config TUTORIAL_0005_WIFI_PASSWORD
    string "WiFi password"
    default ""
    help
        Password for WiFi station connection.

config TUTORIAL_0005_WIFI_MAX_RETRY
    int "Max reconnect retries"
    range 0 50
    default 5
    help
        Maximum number of reconnect retries before giving up.

endmenu
```

## 0006-wifi-http-client/main/Kconfig.projbuild
```kconfig
menu "Tutorial 0006: WiFi + HTTP Client"

config TUTORIAL_0006_WIFI_SSID
    string "WiFi SSID"
    default ""
    help
        SSID for WiFi station connection.

config TUTORIAL_0006_WIFI_PASSWORD
    string "WiFi password"
    default ""
    help
        Password for WiFi station connection.

config TUTORIAL_0006_WIFI_MAX_RETRY
    int "Max reconnect retries"
    range 0 50
    default 5
    help
        Maximum number of reconnect retries before giving up.

config TUTORIAL_0006_HTTP_URL
    string "HTTP URL (http:// or https://)"
    default "http://example.com/"
    help
        URL to fetch periodically.
        - For HTTPS, we attach the ESP-IDF certificate bundle, but TLS may still fail
          if the system time is not set (certificate validity checks).

config TUTORIAL_0006_HTTP_TIMEOUT_MS
    int "HTTP timeout (ms)"
    range 100 60000
    default 5000
    help
        Timeout passed to esp_http_client (in milliseconds).

config TUTORIAL_0006_HTTP_PERIOD_MS
    int "Fetch period (ms)"
    range 100 3600000
    default 10000
    help
        How often to perform the request (in milliseconds).

endmenu
```

## 0007-cardputer-keyboard-serial/main/Kconfig.projbuild
```kconfig
menu "Tutorial 0007: Cardputer Keyboard -> Serial Echo"

config TUTORIAL_0007_SCAN_PERIOD_MS
    int "Keyboard scan period (ms)"
    range 1 1000
    default 10
    help
        How often to scan the keyboard matrix.

config TUTORIAL_0007_DEBOUNCE_MS
    int "Per-key debounce (ms)"
    range 0 1000
    default 30
    help
        Minimum time between emitting the same key again (per key position).
        This is a simple debounce guardrail.

config TUTORIAL_0007_KB_OUT0_GPIO
    int "Keyboard OUT0 GPIO"
    range 0 48
    default 8
    help
        Keyboard scan output pin 0 (Cardputer default: 8).

config TUTORIAL_0007_KB_OUT1_GPIO
    int "Keyboard OUT1 GPIO"
    range 0 48
    default 9
    help
        Keyboard scan output pin 1 (Cardputer default: 9).

config TUTORIAL_0007_KB_OUT2_GPIO
    int "Keyboard OUT2 GPIO"
    range 0 48
    default 11
    help
        Keyboard scan output pin 2 (Cardputer default: 11).

config TUTORIAL_0007_KB_IN0_GPIO
    int "Keyboard IN0 GPIO"
    range 0 48
    default 13
    help
        Keyboard scan input pin 0 (Cardputer default: 13).

config TUTORIAL_0007_KB_IN1_GPIO
    int "Keyboard IN1 GPIO"
    range 0 48
    default 15
    help
        Keyboard scan input pin 1 (Cardputer default: 15).

config TUTORIAL_0007_KB_IN2_GPIO
    int "Keyboard IN2 GPIO"
    range 0 48
    default 3
    help
        Keyboard scan input pin 2 (Cardputer default: 3).

config TUTORIAL_0007_KB_IN3_GPIO
    int "Keyboard IN3 GPIO"
    range 0 48
    default 4
    help
        Keyboard scan input pin 3 (Cardputer default: 4).

config TUTORIAL_0007_KB_IN4_GPIO
    int "Keyboard IN4 GPIO"
    range 0 48
    default 5
    help
        Keyboard scan input pin 4 (Cardputer default: 5).

config TUTORIAL_0007_KB_IN5_GPIO
    int "Keyboard IN5 GPIO"
    range 0 48
    default 6
    help
        Keyboard scan input pin 5 (Cardputer default: 6).

config TUTORIAL_0007_KB_IN6_GPIO
    int "Keyboard IN6 GPIO"
    range 0 48
    default 7
    help
        Keyboard scan input pin 6 (Cardputer default: 7).

endmenu
```

## 0008-atoms3r-display-animation/main/Kconfig.projbuild
```kconfig
menu "Tutorial 0008: AtomS3R Display Animation (GC9107)"

config TUTORIAL_0008_LCD_HRES
    int "Horizontal resolution"
    range 1 1024
    default 128
    help
        LCD horizontal resolution.

config TUTORIAL_0008_LCD_VRES
    int "Vertical resolution"
    range 1 1024
    default 128
    help
        LCD vertical resolution.

config TUTORIAL_0008_LCD_X_OFFSET
    int "X offset (panel RAM window)"
    range 0 64
    default 0
    help
        Optional x-offset if the controller's visible window is shifted.
        GC9107 panels used by M5Stack typically use 0.

config TUTORIAL_0008_LCD_Y_OFFSET
    int "Y offset (panel RAM window)"
    range 0 64
    default 32
    help
        Optional y-offset if the controller's visible window is shifted.
        AtomS3R GC9107 uses a 128x160 internal RAM window; the visible 128x128 area
        typically sits at y-offset 32.

config TUTORIAL_0008_LCD_INVERT_COLOR
    bool "Invert colors"
    default n
    help
        Some panels require color inversion to look correct.

config TUTORIAL_0008_LCD_COLOR_SPACE_BGR
    bool "Use BGR color space (instead of RGB)"
    default y
    help
        Many GC9107 panels use BGR ordering. Toggle if colors look swapped.

config TUTORIAL_0008_LCD_SPI_PCLK_HZ
    int "SPI pixel clock (Hz)"
    range 1000000 80000000
    default 40000000
    help
        SPI clock for LCD transfers. Start conservative (e.g. 26-40MHz).

config TUTORIAL_0008_FRAME_DELAY_MS
    int "Frame delay (ms)"
    range 1 1000
    default 33
    help
        Delay between frames. 33ms ~ 30fps.

config TUTORIAL_0008_SWAP_RGB565_BYTES
    bool "Swap RGB565 bytes before sending over SPI (recommended)"
    default y
    help
        Most SPI LCD controllers expect RGB565 color data in big-endian (MSB first) byte order.
        The ESP32 is little-endian, so a framebuffer of uint16_t pixels will be laid out LSB-first.
        Enable this to byte-swap each RGB565 pixel before calling esp_lcd_panel_draw_bitmap().
        If colors/patterns look like "grid noise" or red/blue are strange, try toggling this.

endmenu

menu "Tutorial 0008: Debug Logging"

config TUTORIAL_0008_LOG_EVERY_N_FRAMES
    int "Log heartbeat every N frames (0=disabled)"
    range 0 10000
    default 60
    help
        Periodically logs a small heartbeat so you know the render loop is alive
        without spamming the serial console. Set to 0 to disable.

endmenu

menu "Tutorial 0008: Backlight"

choice TUTORIAL_0008_BACKLIGHT_MODE
    prompt "Backlight control mode"
    default TUTORIAL_0008_BACKLIGHT_I2C
    help
        AtomS3R backlight control differs by hardware revision.
        - M5GFX indicates AtomS3R backlight is controlled via an I2C device (addr 0x30, reg 0x0e).
        - Some schematics/revisions suggest a GPIO-gated backlight.

    config TUTORIAL_0008_BACKLIGHT_I2C
        bool "I2C brightness device (addr 0x30, reg 0x0e)"

    config TUTORIAL_0008_BACKLIGHT_GPIO
        bool "GPIO on/off (fallback)"

    config TUTORIAL_0008_BACKLIGHT_NONE
        bool "No backlight control (always on externally / unsupported)"
endchoice

config TUTORIAL_0008_BL_I2C_USE_GATE_GPIO
    bool "I2C mode: also drive a backlight gate GPIO (some revisions require this)"
    default y
    depends on TUTORIAL_0008_BACKLIGHT_I2C
    help
        Some AtomS3R schematics/revisions show the LCD backlight being gated by a GPIO-controlled FET
        (commonly GPIO7, active-low). If your backlight seems “stuck off” even though I2C writes succeed,
        enable this and set the gate pin/active-low appropriately.

config TUTORIAL_0008_BL_I2C_GATE_GPIO
    int "I2C mode: backlight gate GPIO"
    range 0 48
    default 7
    depends on TUTORIAL_0008_BACKLIGHT_I2C && TUTORIAL_0008_BL_I2C_USE_GATE_GPIO
    help
        GPIO used to gate/enable the backlight power path (often GPIO7 on AtomS3R).

config TUTORIAL_0008_BL_I2C_GATE_ACTIVE_LOW
    bool "I2C mode: gate GPIO is active-low"
    default y
    depends on TUTORIAL_0008_BACKLIGHT_I2C && TUTORIAL_0008_BL_I2C_USE_GATE_GPIO
    help
        If enabled: drive the gate GPIO LOW to enable the backlight.

config TUTORIAL_0008_BL_I2C_SCL_GPIO
    int "Backlight I2C SCL GPIO"
    range 0 48
    default 0
    depends on TUTORIAL_0008_BACKLIGHT_I2C
    help
        SCL GPIO for the AtomS3R backlight I2C device (M5GFX suggests GPIO0).

config TUTORIAL_0008_BL_I2C_SDA_GPIO
    int "Backlight I2C SDA GPIO"
    range 0 48
    default 45
    depends on TUTORIAL_0008_BACKLIGHT_I2C
    help
        SDA GPIO for the AtomS3R backlight I2C device (M5GFX suggests GPIO45).

config TUTORIAL_0008_BL_I2C_ADDR
    hex "Backlight I2C address"
    default 0x30
    depends on TUTORIAL_0008_BACKLIGHT_I2C
    help
        I2C address for the backlight device (M5GFX suggests 0x30).

config TUTORIAL_0008_BL_I2C_REG
    hex "Backlight brightness register"
    default 0x0e
    depends on TUTORIAL_0008_BACKLIGHT_I2C
    help
        Register for brightness control (M5GFX suggests 0x0e).

config TUTORIAL_0008_BL_BRIGHTNESS_ON
    int "Backlight brightness (0..255)"
    range 0 255
    default 255
    depends on TUTORIAL_0008_BACKLIGHT_I2C
    help
        Brightness value written after panel init. 255 is max brightness.

config TUTORIAL_0008_BL_GPIO
    int "Backlight GPIO"
    range 0 48
    default 7
    depends on TUTORIAL_0008_BACKLIGHT_GPIO
    help
        GPIO to control backlight on/off (fallback for revisions that gate LED_BL via GPIO).

config TUTORIAL_0008_BL_GPIO_ACTIVE_LOW
    bool "Backlight GPIO is active-low"
    default y
    depends on TUTORIAL_0008_BACKLIGHT_GPIO
    help
        If enabled: drive GPIO low to enable the backlight.

endmenu

menu "Tutorial 0008: GC9107 Init Compatibility"

config TUTORIAL_0008_USE_M5GFX_INIT_CMDS
    bool "Use M5GFX-style GC9107 vendor init sequence (more compatible)"
    default y
    help
        The managed esp_lcd_gc9107 component ships with a default vendor init sequence.
        M5GFX uses a slightly different sequence for GC9107 (including 0xFE/0xEF “unlock”
        commands and different gamma tables). If the panel stays black, enable this.

endmenu
```

## 0009-atoms3r-m5gfx-display-animation/main/Kconfig.projbuild
```kconfig
menu "Tutorial 0009: AtomS3R M5GFX Display Animation (GC9107)"

config TUTORIAL_0009_LCD_HRES
    int "Horizontal resolution"
    range 1 1024
    default 128

config TUTORIAL_0009_LCD_VRES
    int "Vertical resolution"
    range 1 1024
    default 128

config TUTORIAL_0009_LCD_X_OFFSET
    int "X offset (panel RAM window)"
    range 0 64
    default 0

config TUTORIAL_0009_LCD_Y_OFFSET
    int "Y offset (panel RAM window)"
    range 0 64
    default 32
    help
        AtomS3R GC9107 uses 128x160 internal RAM; the visible 128x128 window typically sits at y-offset 32.

config TUTORIAL_0009_LCD_INVERT
    bool "Invert colors"
    default n

config TUTORIAL_0009_LCD_RGB_ORDER_RGB
    bool "RGB order (disable for BGR)"
    default n
    help
        In M5GFX/LovyanGFX panel config, rgb_order=true means RGB, rgb_order=false means BGR.

config TUTORIAL_0009_LCD_SPI_PCLK_HZ
    int "SPI pixel clock (Hz)"
    range 1000000 80000000
    default 40000000

config TUTORIAL_0009_FRAME_DELAY_MS
    int "Frame delay (ms)"
    range 1 1000
    default 33

endmenu

menu "Tutorial 0009: Backlight"

config TUTORIAL_0009_BACKLIGHT_GATE_ENABLE
    bool "Drive backlight gate GPIO"
    default y

config TUTORIAL_0009_BACKLIGHT_GATE_GPIO
    int "Backlight gate GPIO"
    range 0 48
    default 7
    depends on TUTORIAL_0009_BACKLIGHT_GATE_ENABLE

config TUTORIAL_0009_BACKLIGHT_GATE_ACTIVE_LOW
    bool "Backlight gate is active-low"
    default y
    depends on TUTORIAL_0009_BACKLIGHT_GATE_ENABLE

config TUTORIAL_0009_BACKLIGHT_I2C_ENABLE
    bool "Use I2C brightness device"
    default y

config TUTORIAL_0009_BL_I2C_SCL_GPIO
    int "Backlight I2C SCL GPIO"
    range 0 48
    default 0
    depends on TUTORIAL_0009_BACKLIGHT_I2C_ENABLE

config TUTORIAL_0009_BL_I2C_SDA_GPIO
    int "Backlight I2C SDA GPIO"
    range 0 48
    default 45
    depends on TUTORIAL_0009_BACKLIGHT_I2C_ENABLE

config TUTORIAL_0009_BL_I2C_ADDR
    hex "Backlight I2C address"
    default 0x30
    depends on TUTORIAL_0009_BACKLIGHT_I2C_ENABLE

config TUTORIAL_0009_BL_I2C_REG
    hex "Backlight brightness register"
    default 0x0e
    depends on TUTORIAL_0009_BACKLIGHT_I2C_ENABLE

config TUTORIAL_0009_BL_BRIGHTNESS_ON
    int "Backlight brightness (0..255)"
    range 0 255
    default 255
    depends on TUTORIAL_0009_BACKLIGHT_I2C_ENABLE

endmenu

menu "Tutorial 0009: Debug Logging"

config TUTORIAL_0009_LOG_EVERY_N_FRAMES
    int "Log heartbeat every N frames (0=disabled)"
    range 0 10000
    default 60

endmenu
```

## 0011-cardputer-m5gfx-plasma-animation/main/Kconfig.projbuild
```kconfig
menu "Tutorial 0011: Cardputer M5GFX Plasma Animation (ST7789)"

config TUTORIAL_0011_FRAME_DELAY_MS
    int "Frame delay (ms)"
    range 0 1000
    default 16

config TUTORIAL_0011_CANVAS_USE_PSRAM
    bool "Allocate M5Canvas sprite in PSRAM (disable for DMA)"
    default n
    help
        When disabled, LovyanGFX allocates sprite buffers using DMA-capable memory,
        which is safest for full-frame updates.

config TUTORIAL_0011_PRESENT_WAIT_DMA
    bool "Wait for DMA completion after present (avoid frame flutter)"
    default y
    help
        When enabled, each frame present is followed by display.waitDMA() so we don't
        start rendering into a buffer that is still being transferred.

config TUTORIAL_0011_LOG_EVERY_N_FRAMES
    int "Log heartbeat every N frames (0=disabled)"
    range 0 10000
    default 60

endmenu
```

## 0011-cardputer-m5gfx-plasma-animation/sdkconfig.defaults
```kconfig
# Tutorial 0011 defaults (ESP-IDF 5.4.1)
#
# Reproducible, board-appropriate defaults for Cardputer.
#

# Flash size: Cardputer is commonly 8MB.
CONFIG_ESPTOOLPY_FLASHSIZE_8MB=y
CONFIG_ESPTOOLPY_FLASHSIZE="8MB"

# Partition table: project-local partitions.csv (factory 4M + storage 1M).
CONFIG_PARTITION_TABLE_CUSTOM=y
CONFIG_PARTITION_TABLE_CUSTOM_FILENAME="partitions.csv"
CONFIG_PARTITION_TABLE_FILENAME="partitions.csv"

# CPU frequency: Cardputer demos usually run at 240MHz.
CONFIG_ESP_DEFAULT_CPU_FREQ_MHZ_240=y
CONFIG_ESP_DEFAULT_CPU_FREQ_MHZ=240

# Main task stack: M5GFX is C++ and can be stack-hungry.
CONFIG_ESP_MAIN_TASK_STACK_SIZE=8000

# Tutorial defaults:
CONFIG_TUTORIAL_0011_FRAME_DELAY_MS=16
CONFIG_TUTORIAL_0011_CANVAS_USE_PSRAM=n
CONFIG_TUTORIAL_0011_PRESENT_WAIT_DMA=y
CONFIG_TUTORIAL_0011_LOG_EVERY_N_FRAMES=60
```
