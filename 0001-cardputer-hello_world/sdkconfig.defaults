## 0016-atoms3r-grove-gpio-signal-tester/main/Kconfig.projbuild
```kconfig
menu "Tutorial 0016: AtomS3R GROVE GPIO signal tester"

config TUTORIAL_0016_DEFAULT_ACTIVE_PIN
    int "Default active pin (1=GPIO1, 2=GPIO2)"
    range 1 2
    default 2

config TUTORIAL_0016_UI_REFRESH_MS
    int "LCD UI refresh interval (ms)"
    range 20 2000
    default 100

config TUTORIAL_0016_CONSOLE_PROMPT
    string "REPL prompt"
    default "sig> "

menu "Tutorial 0016: LCD (AtomS3R GC9107 via M5GFX)"

config TUTORIAL_0016_LCD_HRES
    int "Horizontal resolution"
    range 1 1024
    default 128

config TUTORIAL_0016_LCD_VRES
    int "Vertical resolution"
    range 1 1024
    default 128

config TUTORIAL_0016_LCD_X_OFFSET
    int "X offset (panel RAM window)"
    range 0 64
    default 0

config TUTORIAL_0016_LCD_Y_OFFSET
    int "Y offset (panel RAM window)"
    range 0 64
    default 32
    help
        AtomS3R GC9107 uses 128x160 internal RAM; the visible 128x128 window typically sits at y-offset 32.

config TUTORIAL_0016_LCD_INVERT
    bool "Invert colors"
    default n

config TUTORIAL_0016_LCD_RGB_ORDER_RGB
    bool "RGB order (disable for BGR)"
    default n

config TUTORIAL_0016_LCD_SPI_PCLK_HZ
    int "SPI pixel clock (Hz)"
    range 1000000 80000000
    default 40000000

endmenu

menu "Tutorial 0016: Canvas / Present"

config TUTORIAL_0016_CANVAS_USE_PSRAM
    bool "Allocate M5Canvas sprite in PSRAM (disable for DMA)"
    default n

config TUTORIAL_0016_PRESENT_USE_DMA
    bool "Wait for DMA completion after present (avoid tearing)"
    default y

endmenu

menu "Tutorial 0016: Backlight"

config TUTORIAL_0016_BACKLIGHT_GATE_ENABLE
    bool "Drive backlight gate GPIO"
    default y

config TUTORIAL_0016_BACKLIGHT_GATE_GPIO
    int "Backlight gate GPIO"
    range 0 48
    default 7
    depends on TUTORIAL_0016_BACKLIGHT_GATE_ENABLE

config TUTORIAL_0016_BACKLIGHT_GATE_ACTIVE_LOW
    bool "Backlight gate is active-low"
    default y
    depends on TUTORIAL_0016_BACKLIGHT_GATE_ENABLE

config TUTORIAL_0016_BACKLIGHT_I2C_ENABLE
    bool "Use I2C brightness device"
    default y

config TUTORIAL_0016_BL_I2C_SCL_GPIO
    int "Backlight I2C SCL GPIO"
    range 0 48
    default 0
    depends on TUTORIAL_0016_BACKLIGHT_I2C_ENABLE

config TUTORIAL_0016_BL_I2C_SDA_GPIO
    int "Backlight I2C SDA GPIO"
    range 0 48
    default 45
    depends on TUTORIAL_0016_BACKLIGHT_I2C_ENABLE

config TUTORIAL_0016_BL_I2C_ADDR
    hex "Backlight I2C address"
    default 0x30
    depends on TUTORIAL_0016_BACKLIGHT_I2C_ENABLE

config TUTORIAL_0016_BL_I2C_REG
    hex "Backlight brightness register"
    default 0x0e
    depends on TUTORIAL_0016_BACKLIGHT_I2C_ENABLE

config TUTORIAL_0016_BL_BRIGHTNESS_ON
    int "Backlight brightness (0..255)"
    range 0 255
    default 255
    depends on TUTORIAL_0016_BACKLIGHT_I2C_ENABLE

endmenu

endmenu
```

## 0016-atoms3r-grove-gpio-signal-tester/sdkconfig.defaults
```kconfig
# Tutorial 0016 defaults (ESP-IDF 5.4.1)
#
# Reproducible defaults for AtomS3R.
#

# Flash size: AtomS3R commonly 8MB.
CONFIG_ESPTOOLPY_FLASHSIZE_8MB=y
CONFIG_ESPTOOLPY_FLASHSIZE="8MB"

# CPU frequency: demos usually run at 240MHz.
CONFIG_ESP_DEFAULT_CPU_FREQ_MHZ_240=y
CONFIG_ESP_DEFAULT_CPU_FREQ_MHZ=240

# Main task stack: C++ + M5GFX can be stack-hungry.
CONFIG_ESP_MAIN_TASK_STACK_SIZE=8000

# Use USB Serial/JTAG as the primary console channel (control plane).
CONFIG_ESP_CONSOLE_USB_SERIAL_JTAG=y
CONFIG_ESP_CONSOLE_UART_DEFAULT=n
CONFIG_ESP_CONSOLE_UART_CUSTOM=n
CONFIG_ESP_CONSOLE_USB_CDC=n

# UI defaults (AtomS3R GC9107, 128x128 window in 128x160 RAM)
CONFIG_TUTORIAL_0016_LCD_HRES=128
CONFIG_TUTORIAL_0016_LCD_VRES=128
CONFIG_TUTORIAL_0016_LCD_X_OFFSET=0
CONFIG_TUTORIAL_0016_LCD_Y_OFFSET=32
CONFIG_TUTORIAL_0016_LCD_SPI_PCLK_HZ=40000000
CONFIG_TUTORIAL_0016_LCD_INVERT=n
CONFIG_TUTORIAL_0016_LCD_RGB_ORDER_RGB=n
CONFIG_TUTORIAL_0016_CANVAS_USE_PSRAM=n
CONFIG_TUTORIAL_0016_PRESENT_USE_DMA=y

# Backlight defaults (AtomS3R commonly uses both gate GPIO and I2C brightness device).
CONFIG_TUTORIAL_0016_BACKLIGHT_GATE_ENABLE=y
CONFIG_TUTORIAL_0016_BACKLIGHT_GATE_GPIO=7
CONFIG_TUTORIAL_0016_BACKLIGHT_GATE_ACTIVE_LOW=y
CONFIG_TUTORIAL_0016_BACKLIGHT_I2C_ENABLE=y
CONFIG_TUTORIAL_0016_BL_I2C_SCL_GPIO=0
CONFIG_TUTORIAL_0016_BL_I2C_SDA_GPIO=45
CONFIG_TUTORIAL_0016_BL_I2C_ADDR=0x30
CONFIG_TUTORIAL_0016_BL_I2C_REG=0x0e
CONFIG_TUTORIAL_0016_BL_BRIGHTNESS_ON=255

# Console + UI behavior
CONFIG_TUTORIAL_0016_CONSOLE_PROMPT="sig> "
CONFIG_TUTORIAL_0016_UI_REFRESH_MS=100
CONFIG_TUTORIAL_0016_DEFAULT_ACTIVE_PIN=2
```

## 0017-atoms3r-web-ui/main/Kconfig.projbuild
```kconfig
menu "Tutorial 0017: AtomS3R Web UI (graphics upload + WebSocket terminal)"

menu "Tutorial 0017: LCD (AtomS3R GC9107 via M5GFX)"

config TUTORIAL_0017_LCD_HRES
    int "Horizontal resolution"
    range 1 1024
    default 128

config TUTORIAL_0017_LCD_VRES
    int "Vertical resolution"
    range 1 1024
    default 128

config TUTORIAL_0017_LCD_X_OFFSET
    int "X offset (panel RAM window)"
    range 0 64
    default 0

config TUTORIAL_0017_LCD_Y_OFFSET
    int "Y offset (panel RAM window)"
    range 0 64
    default 32
    help
        AtomS3R GC9107 uses 128x160 internal RAM; the visible 128x128 window typically sits at y-offset 32.

config TUTORIAL_0017_LCD_INVERT
    bool "Invert colors"
    default n

config TUTORIAL_0017_LCD_RGB_ORDER_RGB
    bool "RGB order (disable for BGR)"
    default n

config TUTORIAL_0017_LCD_SPI_PCLK_HZ
    int "SPI pixel clock (Hz)"
    range 1000000 80000000
    default 40000000

endmenu

menu "Tutorial 0017: Canvas / Present"

config TUTORIAL_0017_CANVAS_USE_PSRAM
    bool "Allocate M5Canvas sprite in PSRAM (disable for DMA)"
    default n

config TUTORIAL_0017_PRESENT_USE_DMA
    bool "Wait for DMA completion after present (avoid tearing)"
    default y

endmenu

menu "Tutorial 0017: Backlight"

config TUTORIAL_0017_BACKLIGHT_GATE_ENABLE
    bool "Drive backlight gate GPIO"
    default y

config TUTORIAL_0017_BACKLIGHT_GATE_GPIO
    int "Backlight gate GPIO"
    range 0 48
    default 7
    depends on TUTORIAL_0017_BACKLIGHT_GATE_ENABLE

config TUTORIAL_0017_BACKLIGHT_GATE_ACTIVE_LOW
    bool "Backlight gate is active-low"
    default y
    depends on TUTORIAL_0017_BACKLIGHT_GATE_ENABLE

config TUTORIAL_0017_BACKLIGHT_I2C_ENABLE
    bool "Use I2C brightness device"
    default y

config TUTORIAL_0017_BL_I2C_SCL_GPIO
    int "Backlight I2C SCL GPIO"
    range 0 48
    default 0
    depends on TUTORIAL_0017_BACKLIGHT_I2C_ENABLE

config TUTORIAL_0017_BL_I2C_SDA_GPIO
    int "Backlight I2C SDA GPIO"
    range 0 48
    default 45
    depends on TUTORIAL_0017_BACKLIGHT_I2C_ENABLE

config TUTORIAL_0017_BL_I2C_ADDR
    hex "Backlight I2C address"
    default 0x30
    depends on TUTORIAL_0017_BACKLIGHT_I2C_ENABLE

config TUTORIAL_0017_BL_I2C_REG
    hex "Backlight brightness register"
    default 0x0e
    depends on TUTORIAL_0017_BACKLIGHT_I2C_ENABLE

config TUTORIAL_0017_BL_BRIGHTNESS_ON
    int "Backlight brightness (0..255)"
    range 0 255
    default 255
    depends on TUTORIAL_0017_BACKLIGHT_I2C_ENABLE

endmenu

menu "Tutorial 0017: WiFi"

choice TUTORIAL_0017_WIFI_MODE
    prompt "WiFi mode"
    default TUTORIAL_0017_WIFI_MODE_SOFTAP
    help
        Choose how the device gets network connectivity:
        - SoftAP: device hosts a WiFi network (clients connect to it)
        - STA (DHCP): device joins an existing WiFi and gets an IP via DHCP
        - AP+STA: keep SoftAP up while also joining an existing WiFi

config TUTORIAL_0017_WIFI_MODE_SOFTAP
    bool "SoftAP (device-hosted network)"

config TUTORIAL_0017_WIFI_MODE_STA
    bool "STA (join existing network, DHCP)"

config TUTORIAL_0017_WIFI_MODE_APSTA
    bool "AP+STA (SoftAP + join existing network)"

endchoice

menu "SoftAP settings"

config TUTORIAL_0017_WIFI_SOFTAP_SSID
    string "SoftAP SSID"
    default "AtomS3R-WebUI"

config TUTORIAL_0017_WIFI_SOFTAP_PASSWORD
    string "SoftAP password (empty=open)"
    default ""

config TUTORIAL_0017_WIFI_SOFTAP_CHANNEL
    int "SoftAP channel"
    range 1 13
    default 6

config TUTORIAL_0017_WIFI_SOFTAP_MAX_CONN
    int "SoftAP max connections"
    range 1 10
    default 4

endmenu

menu "STA (join existing WiFi) settings"

config TUTORIAL_0017_WIFI_STA_SSID
    string "STA SSID"
    default ""
    depends on TUTORIAL_0017_WIFI_MODE_STA || TUTORIAL_0017_WIFI_MODE_APSTA

config TUTORIAL_0017_WIFI_STA_PASSWORD
    string "STA password"
    default ""
    depends on TUTORIAL_0017_WIFI_MODE_STA || TUTORIAL_0017_WIFI_MODE_APSTA

config TUTORIAL_0017_WIFI_STA_HOSTNAME
    string "DHCP hostname (optional)"
    default "atoms3r-webui"
    depends on TUTORIAL_0017_WIFI_MODE_STA || TUTORIAL_0017_WIFI_MODE_APSTA

config TUTORIAL_0017_WIFI_STA_CONNECT_TIMEOUT_MS
    int "Connect timeout (ms)"
    range 1000 60000
    default 15000
    depends on TUTORIAL_0017_WIFI_MODE_STA || TUTORIAL_0017_WIFI_MODE_APSTA

config TUTORIAL_0017_WIFI_STA_FALLBACK_TO_SOFTAP
    bool "If STA fails, fall back to SoftAP"
    default y
    depends on TUTORIAL_0017_WIFI_MODE_STA
    help
        If enabled and the device fails to acquire a DHCP lease within the timeout,
        it will bring up SoftAP so you can still connect for debugging.

endmenu

endmenu

menu "Tutorial 0017: Storage (FATFS RW for uploads)"

config TUTORIAL_0017_STORAGE_PARTITION_LABEL
    string "FATFS partition label"
    default "storage"

config TUTORIAL_0017_STORAGE_MOUNT_PATH
    string "Mount path"
    default "/storage"

config TUTORIAL_0017_STORAGE_GRAPHICS_DIR
    string "Graphics dir"
    default "/storage/graphics"

config TUTORIAL_0017_MAX_UPLOAD_BYTES
    int "Max upload bytes"
    range 1024 10485760
    default 262144

endmenu

menu "Tutorial 0017: UART terminal (GROVE)"

config TUTORIAL_0017_UART_NUM
    int "UART channel"
    range 0 2
    default 1

config TUTORIAL_0017_UART_BAUDRATE
    int "UART baud rate"
    range 1200 3000000
    default 115200

config TUTORIAL_0017_UART_TX_GPIO
    int "UART TX GPIO (to adapter RX)"
    range -1 48
    default 1

config TUTORIAL_0017_UART_RX_GPIO
    int "UART RX GPIO (to adapter TX)"
    range -1 48
    default 2

endmenu

menu "Tutorial 0017: Button input"

config TUTORIAL_0017_BUTTON_GPIO
    int "Button GPIO"
    range 0 48
    default 41
    help
        GPIO for the AtomS3R button. Defaults to 41 on some revisions; override if needed.

config TUTORIAL_0017_BUTTON_ACTIVE_LOW
    bool "Button is active-low (pressed=0)"
    default y

config TUTORIAL_0017_BUTTON_DEBOUNCE_MS
    int "Debounce window (ms)"
    range 0 1000
    default 50

endmenu

endmenu
```

## 0017-atoms3r-web-ui/sdkconfig.defaults
```kconfig
# Tutorial 0017 defaults (ESP-IDF 5.4.1)
#
# Reproducible defaults for AtomS3R Web UI demo.
#

# Flash size: AtomS3R commonly 8MB.
CONFIG_ESPTOOLPY_FLASHSIZE_8MB=y
CONFIG_ESPTOOLPY_FLASHSIZE="8MB"

# Partition table: project-local partitions.csv (factory 2M + storage ~6M).
CONFIG_PARTITION_TABLE_CUSTOM=y
CONFIG_PARTITION_TABLE_CUSTOM_FILENAME="partitions.csv"
CONFIG_PARTITION_TABLE_FILENAME="partitions.csv"

# CPU frequency: demos usually run at 240MHz.
CONFIG_ESP_DEFAULT_CPU_FREQ_MHZ_240=y
CONFIG_ESP_DEFAULT_CPU_FREQ_MHZ=240

# Main task stack: C++ + M5GFX can be stack-hungry.
CONFIG_ESP_MAIN_TASK_STACK_SIZE=8000

# Use USB Serial/JTAG as the primary console channel (keep GROVE UART free for terminal feature).
CONFIG_ESP_CONSOLE_USB_SERIAL_JTAG=y
CONFIG_ESP_CONSOLE_UART_DEFAULT=n
CONFIG_ESP_CONSOLE_UART_CUSTOM=n
CONFIG_ESP_CONSOLE_USB_CDC=n

# HTTP server: enable WebSocket support (for /ws terminal + button events).
CONFIG_HTTPD_WS_SUPPORT=y

# FATFS: enable long file name support for uploaded graphics.
CONFIG_FATFS_LFN_HEAP=y
CONFIG_FATFS_MAX_LFN=255

# UI defaults (AtomS3R GC9107, 128x128 window in 128x160 RAM)
CONFIG_TUTORIAL_0017_LCD_HRES=128
CONFIG_TUTORIAL_0017_LCD_VRES=128
CONFIG_TUTORIAL_0017_LCD_X_OFFSET=0
CONFIG_TUTORIAL_0017_LCD_Y_OFFSET=32
CONFIG_TUTORIAL_0017_LCD_SPI_PCLK_HZ=40000000
CONFIG_TUTORIAL_0017_LCD_INVERT=n
CONFIG_TUTORIAL_0017_LCD_RGB_ORDER_RGB=n
CONFIG_TUTORIAL_0017_CANVAS_USE_PSRAM=n
CONFIG_TUTORIAL_0017_PRESENT_USE_DMA=y

# Backlight defaults (AtomS3R commonly uses both gate GPIO and I2C brightness device).
CONFIG_TUTORIAL_0017_BACKLIGHT_GATE_ENABLE=y
CONFIG_TUTORIAL_0017_BACKLIGHT_GATE_GPIO=7
CONFIG_TUTORIAL_0017_BACKLIGHT_GATE_ACTIVE_LOW=y
CONFIG_TUTORIAL_0017_BACKLIGHT_I2C_ENABLE=y
CONFIG_TUTORIAL_0017_BL_I2C_SCL_GPIO=0
CONFIG_TUTORIAL_0017_BL_I2C_SDA_GPIO=45
CONFIG_TUTORIAL_0017_BL_I2C_ADDR=0x30
CONFIG_TUTORIAL_0017_BL_I2C_REG=0x0e
CONFIG_TUTORIAL_0017_BL_BRIGHTNESS_ON=255

# Button defaults (revision-dependent; override if needed).
CONFIG_TUTORIAL_0017_BUTTON_GPIO=41
CONFIG_TUTORIAL_0017_BUTTON_ACTIVE_LOW=y
CONFIG_TUTORIAL_0017_BUTTON_DEBOUNCE_MS=50

# UART defaults (GROVE Port.A defaults: G1=GPIO1, G2=GPIO2).
CONFIG_TUTORIAL_0017_UART_NUM=1
CONFIG_TUTORIAL_0017_UART_BAUDRATE=115200
CONFIG_TUTORIAL_0017_UART_TX_GPIO=1
CONFIG_TUTORIAL_0017_UART_RX_GPIO=2

# Storage defaults
CONFIG_TUTORIAL_0017_STORAGE_PARTITION_LABEL="storage"
CONFIG_TUTORIAL_0017_STORAGE_MOUNT_PATH="/storage"
CONFIG_TUTORIAL_0017_STORAGE_GRAPHICS_DIR="/storage/graphics"
CONFIG_TUTORIAL_0017_MAX_UPLOAD_BYTES=262144

# SoftAP defaults
CONFIG_TUTORIAL_0017_WIFI_SOFTAP_SSID="AtomS3R-WebUI"
CONFIG_TUTORIAL_0017_WIFI_SOFTAP_PASSWORD=""
CONFIG_TUTORIAL_0017_WIFI_SOFTAP_CHANNEL=6
CONFIG_TUTORIAL_0017_WIFI_SOFTAP_MAX_CONN=4
```

## 0018-qemu-uart-echo-firmware/sdkconfig.defaults
```kconfig
# Track C defaults: keep QEMU-friendly and avoid USB-Serial-JTAG console.
#
# Goal: make UART0 the only console and avoid secondary console channels that
# are not emulated under QEMU.

# Use UART as primary console.
CONFIG_ESP_CONSOLE_UART_DEFAULT=y
CONFIG_ESP_CONSOLE_UART=y
CONFIG_ESP_CONSOLE_UART_NUM=0
CONFIG_ESP_CONSOLE_UART_BAUDRATE=115200

# Disable USB console options.
CONFIG_ESP_CONSOLE_USB_SERIAL_JTAG=n
CONFIG_ESP_CONSOLE_USB_CDC=n

# Disable secondary console (important for QEMU runs).
CONFIG_ESP_CONSOLE_SECONDARY_NONE=y
CONFIG_ESP_CONSOLE_SECONDARY_USB_SERIAL_JTAG=n
CONFIG_ESP_CONSOLE_USB_SERIAL_JTAG_ENABLED=n

# Conservative flash settings (QEMU tends to be stricter than hardware).
CONFIG_ESPTOOLPY_FLASHMODE_DIO=y
CONFIG_ESPTOOLPY_FLASHFREQ_80M=y
CONFIG_ESPTOOLPY_FLASHSIZE_2MB=y

# Disable watchdogs for QEMU runs.
#
# ESP-IDF's QEMU runner attempts to disable the timer-group WDT via a QEMU
# "-global ...wdt_disable..." knob, but on esp32s3 QEMU this can be ignored
# (you'll see "warning: global timer.esp32s3.timg.wdt_disable has invalid class name"),
# which leads to early Task WDT interrupts and panics before `app_main` runs.
CONFIG_ESP_TASK_WDT_EN=n
CONFIG_ESP_INT_WDT=n
```

## 0019-cardputer-ble-temp-logger/sdkconfig.defaults
```kconfig
# Tutorial 0019 defaults (ESP-IDF 5.4.1)
#
# Reproducible, board-appropriate defaults for Cardputer + BLE.
#

# Flash size: Cardputer is commonly 8MB.
CONFIG_ESPTOOLPY_FLASHSIZE_8MB=y
CONFIG_ESPTOOLPY_FLASHSIZE="8MB"

# Partition table: project-local partitions.csv (factory 4M + storage 1M).
CONFIG_PARTITION_TABLE_CUSTOM=y
CONFIG_PARTITION_TABLE_CUSTOM_FILENAME="partitions.csv"
CONFIG_PARTITION_TABLE_FILENAME="partitions.csv"

# CPU frequency: Cardputer demos usually run at 240MHz.
CONFIG_ESP_DEFAULT_CPU_FREQ_MHZ_240=y
CONFIG_ESP_DEFAULT_CPU_FREQ_MHZ=240

# Main task stack: BLE + app logging can be a bit stack-hungry.
CONFIG_ESP_MAIN_TASK_STACK_SIZE=8000

# Bluetooth / BLE (Bluedroid)
CONFIG_BT_ENABLED=y
CONFIG_BT_BLE_ENABLED=y
CONFIG_BT_CLASSIC_ENABLED=n
CONFIG_BT_BLUEDROID_ENABLED=y
# CONFIG_BT_NIMBLE_ENABLED is not set

# BLE feature set (ESP-IDF 5.4.1 / Bluedroid):
# BLE 4.2 and BLE 5.0 cannot be enabled simultaneously (see ESP-IDF Bluedroid Kconfig.in).
# For this project we intentionally use BLE 5.0 + extended advertising APIs (`esp_ble_gap_ext_adv_*`).
CONFIG_BT_BLE_50_FEATURES_SUPPORTED=y
CONFIG_BT_BLE_42_FEATURES_SUPPORTED=n

# Allow GATT server (Bluedroid).
CONFIG_BT_GATTS_ENABLE=y
CONFIG_BT_GATTC_ENABLE=n
```
