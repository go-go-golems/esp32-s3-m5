## 0012-cardputer-typewriter/main/Kconfig.projbuild
```kconfig
menu "Tutorial 0012: Cardputer Typewriter (keyboard -> on-screen text)"

config TUTORIAL_0012_PRESENT_WAIT_DMA
    bool "Wait for DMA completion after present (avoid tearing)"
    default y
    help
        When enabled, each present is followed by display.waitDMA() so we don't
        start rendering into a buffer that is still being transferred.

config TUTORIAL_0012_CANVAS_USE_PSRAM
    bool "Allocate M5Canvas sprite in PSRAM (disable for DMA)"
    default n
    help
        When disabled, LovyanGFX allocates sprite buffers using DMA-capable memory,
        which is safest for full-frame updates.

config TUTORIAL_0012_LOG_EVERY_N_EVENTS
    int "Log heartbeat every N key events (0=disabled)"
    range 0 100000
    default 0

config TUTORIAL_0012_MAX_LINES
    int "Maximum stored lines in buffer"
    range 16 4096
    default 256

config TUTORIAL_0012_SCAN_PERIOD_MS
    int "Keyboard scan period (ms)"
    range 1 1000
    default 10
    help
        How often to scan the keyboard matrix.

config TUTORIAL_0012_DEBOUNCE_MS
    int "Per-key debounce (ms)"
    range 0 1000
    default 30
    help
        Minimum time between emitting the same key again (per key position).
        This is a simple debounce guardrail.

config TUTORIAL_0012_SCAN_SETTLE_US
    int "Settle delay after changing scan outputs (us)"
    range 0 1000
    default 30
    help
        Small delay after updating the 3 output pins before reading input pins.
        Some boards/wiring benefit from a short settle time.

config TUTORIAL_0012_AUTODETECT_IN01
    bool "Autodetect IN0/IN1 pins (13/15 vs 1/2)"
    default y
    help
        Some Cardputer revisions appear to route keyboard IN0/IN1 to GPIO1/GPIO2 instead of GPIO13/GPIO15.
        When enabled, the firmware will automatically switch to the alternate pin pair if key activity is detected there.

config TUTORIAL_0012_KB_ALT_IN0_GPIO
    int "Alt IN0 GPIO (autodetect)"
    range 0 48
    default 1
    depends on TUTORIAL_0012_AUTODETECT_IN01

config TUTORIAL_0012_KB_ALT_IN1_GPIO
    int "Alt IN1 GPIO (autodetect)"
    range 0 48
    default 2
    depends on TUTORIAL_0012_AUTODETECT_IN01

config TUTORIAL_0012_DEBUG_RAW_SCAN
    bool "Debug: log raw scan masks when keys are detected"
    default n
    help
        When enabled, logs the raw per-scan-state input mask whenever a key press is detected.

config TUTORIAL_0012_LOG_KEY_EVENTS
    bool "Debug: log a line for every key press event"
    default n
    help
        When enabled, prints an ESP_LOGI line for every emitted key press event.

config TUTORIAL_0012_KB_OUT0_GPIO
    int "Keyboard OUT0 GPIO"
    range 0 48
    default 8
    help
        Keyboard scan output pin 0 (Cardputer default: 8).

config TUTORIAL_0012_KB_OUT1_GPIO
    int "Keyboard OUT1 GPIO"
    range 0 48
    default 9
    help
        Keyboard scan output pin 1 (Cardputer default: 9).

config TUTORIAL_0012_KB_OUT2_GPIO
    int "Keyboard OUT2 GPIO"
    range 0 48
    default 11
    help
        Keyboard scan output pin 2 (Cardputer default: 11).

config TUTORIAL_0012_KB_IN0_GPIO
    int "Keyboard IN0 GPIO"
    range 0 48
    default 13
    help
        Keyboard scan input pin 0 (Cardputer default: 13).

config TUTORIAL_0012_KB_IN1_GPIO
    int "Keyboard IN1 GPIO"
    range 0 48
    default 15
    help
        Keyboard scan input pin 1 (Cardputer default: 15).

config TUTORIAL_0012_KB_IN2_GPIO
    int "Keyboard IN2 GPIO"
    range 0 48
    default 3
    help
        Keyboard scan input pin 2 (Cardputer default: 3).

config TUTORIAL_0012_KB_IN3_GPIO
    int "Keyboard IN3 GPIO"
    range 0 48
    default 4
    help
        Keyboard scan input pin 3 (Cardputer default: 4).

config TUTORIAL_0012_KB_IN4_GPIO
    int "Keyboard IN4 GPIO"
    range 0 48
    default 5
    help
        Keyboard scan input pin 4 (Cardputer default: 5).

config TUTORIAL_0012_KB_IN5_GPIO
    int "Keyboard IN5 GPIO"
    range 0 48
    default 6
    help
        Keyboard scan input pin 5 (Cardputer default: 6).

config TUTORIAL_0012_KB_IN6_GPIO
    int "Keyboard IN6 GPIO"
    range 0 48
    default 7
    help
        Keyboard scan input pin 6 (Cardputer default: 7).

endmenu
```

## 0013-atoms3r-gif-console/main/Kconfig.projbuild
```kconfig
menu "Tutorial 0013: AtomS3R \"GIF Console\" MVP (mock animations)"

config TUTORIAL_0013_LCD_HRES
    int "Horizontal resolution"
    range 1 1024
    default 128

config TUTORIAL_0013_LCD_VRES
    int "Vertical resolution"
    range 1 1024
    default 128

config TUTORIAL_0013_LCD_X_OFFSET
    int "X offset (panel RAM window)"
    range 0 64
    default 0

config TUTORIAL_0013_LCD_Y_OFFSET
    int "Y offset (panel RAM window)"
    range 0 64
    default 32
    help
        AtomS3R GC9107 uses 128x160 internal RAM; the visible 128x128 window typically sits at y-offset 32.

config TUTORIAL_0013_LCD_INVERT
    bool "Invert colors"
    default n

config TUTORIAL_0013_LCD_RGB_ORDER_RGB
    bool "RGB order (disable for BGR)"
    default n
    help
        In M5GFX/LovyanGFX panel config, rgb_order=true means RGB, rgb_order=false means BGR.

config TUTORIAL_0013_LCD_SPI_PCLK_HZ
    int "SPI pixel clock (Hz)"
    range 1000000 80000000
    default 40000000

config TUTORIAL_0013_FRAME_DELAY_MS
    int "Frame delay (ms) for mock animations"
    range 1 1000
    default 100

endmenu

menu "Tutorial 0013: Console / esp_console"

choice TUTORIAL_0013_CONSOLE_BINDING
    prompt "Console binding (interactive REPL transport)"
    default TUTORIAL_0013_CONSOLE_BINDING_GROVE_UART
    help
        Select where the esp_console REPL should be bound.

        Notes:
        - This controls which `esp_console_new_repl_*()` helper we start in this tutorial.
        - The ESP-IDF "Console" component settings (Component config → Console) still
          control which transport is enabled/compiled.

config TUTORIAL_0013_CONSOLE_BINDING_GROVE_UART
    bool "UART on GROVE (G1/G2)"
    depends on ESP_CONSOLE_UART_CUSTOM
    help
        Bind the REPL to an external UART connected via the AtomS3R GROVE Port.A pins.
        Default pinout for AtomS3R: G1=GPIO1, G2=GPIO2.

        Requires ESP-IDF's console output channel to be set to Custom UART:
        Component config → ESP System Settings → Channel for console output → Custom UART

config TUTORIAL_0013_CONSOLE_BINDING_USB_SERIAL_JTAG
    bool "USB Serial/JTAG"
    depends on ESP_CONSOLE_USB_SERIAL_JTAG
    help
        Bind the REPL to the built-in USB Serial/JTAG interface (ESP32-S3).
        Requires ESP-IDF's console output channel to be set to USB Serial/JTAG:
        Component config → ESP System Settings → Channel for console output → USB Serial/JTAG Controller

endchoice

config TUTORIAL_0013_CONSOLE_UART_NUM
    int "UART channel"
    range 0 2
    default 1
    depends on TUTORIAL_0013_CONSOLE_BINDING_GROVE_UART
    help
        UART controller used for the REPL. UART1 is a good default for external wiring.

config TUTORIAL_0013_CONSOLE_UART_BAUDRATE
    int "UART baud rate"
    range 1200 3000000
    default 115200
    depends on TUTORIAL_0013_CONSOLE_BINDING_GROVE_UART

config TUTORIAL_0013_CONSOLE_UART_TX_GPIO
    int "UART TX GPIO (to adapter RX)"
    range -1 48
    default 1
    depends on TUTORIAL_0013_CONSOLE_BINDING_GROVE_UART

config TUTORIAL_0013_CONSOLE_UART_RX_GPIO
    int "UART RX GPIO (to adapter TX)"
    range -1 48
    default 2
    depends on TUTORIAL_0013_CONSOLE_BINDING_GROVE_UART

config TUTORIAL_0013_CONSOLE_PROMPT
    string "REPL prompt"
    default "gif> "

endmenu

menu "Tutorial 0013: Console Debug"

config TUTORIAL_0013_CONSOLE_RX_HEARTBEAT_ENABLE
    bool "Log UART RX heartbeat (edge counter on RX GPIO)"
    default y
    depends on TUTORIAL_0013_CONSOLE_BINDING_GROVE_UART
    help
        When enabled, installs a GPIO interrupt handler on the configured UART RX GPIO
        (default: GPIO2 / GROVE G2) and logs a periodic heartbeat showing how many edges
        were observed.

        This is a non-invasive debug tool to answer: "Is the AtomS3R *physically* seeing UART RX traffic?"
        It does NOT consume UART bytes, so it should not interfere with esp_console.

config TUTORIAL_0013_CONSOLE_RX_HEARTBEAT_INTERVAL_MS
    int "UART RX heartbeat interval (ms)"
    range 100 10000
    default 1000
    depends on TUTORIAL_0013_CONSOLE_RX_HEARTBEAT_ENABLE

endmenu

menu "Tutorial 0013: Canvas / Present"

config TUTORIAL_0013_CANVAS_USE_PSRAM
    bool "Allocate M5Canvas sprite in PSRAM (disable for DMA)"
    default n
    help
        When disabled, LovyanGFX allocates sprite buffers using AllocationSource::Dma,
        which is DMA-capable and safest for full-frame updates.

config TUTORIAL_0013_PRESENT_USE_DMA
    bool "Present frames using SPI DMA (pushImageDMA + waitDMA)"
    default y
    help
        When enabled, each frame is pushed via DMA and we explicitly wait for completion
        before rendering the next frame, to avoid frame-rate \"flutter\".

endmenu

menu "Tutorial 0013: Backlight"

config TUTORIAL_0013_BACKLIGHT_GATE_ENABLE
    bool "Drive backlight gate GPIO"
    default y

config TUTORIAL_0013_BACKLIGHT_GATE_GPIO
    int "Backlight gate GPIO"
    range 0 48
    default 7
    depends on TUTORIAL_0013_BACKLIGHT_GATE_ENABLE

config TUTORIAL_0013_BACKLIGHT_GATE_ACTIVE_LOW
    bool "Backlight gate is active-low"
    default y
    depends on TUTORIAL_0013_BACKLIGHT_GATE_ENABLE

config TUTORIAL_0013_BACKLIGHT_I2C_ENABLE
    bool "Use I2C brightness device"
    default y

config TUTORIAL_0013_BL_I2C_SCL_GPIO
    int "Backlight I2C SCL GPIO"
    range 0 48
    default 0
    depends on TUTORIAL_0013_BACKLIGHT_I2C_ENABLE

config TUTORIAL_0013_BL_I2C_SDA_GPIO
    int "Backlight I2C SDA GPIO"
    range 0 48
    default 45
    depends on TUTORIAL_0013_BACKLIGHT_I2C_ENABLE

config TUTORIAL_0013_BL_I2C_ADDR
    hex "Backlight I2C address"
    default 0x30
    depends on TUTORIAL_0013_BACKLIGHT_I2C_ENABLE

config TUTORIAL_0013_BL_I2C_REG
    hex "Backlight brightness register"
    default 0x0e
    depends on TUTORIAL_0013_BACKLIGHT_I2C_ENABLE

config TUTORIAL_0013_BL_BRIGHTNESS_ON
    int "Backlight brightness (0..255)"
    range 0 255
    default 255
    depends on TUTORIAL_0013_BACKLIGHT_I2C_ENABLE

endmenu

menu "Tutorial 0013: Input / Button"

config TUTORIAL_0013_BUTTON_GPIO
    int "Next-animation button GPIO"
    range 0 48
    default 41
    help
        GPIO for the \"next animation\" button. Defaults to 41 (AtomS3R button on some revisions).
        If your board uses a different pin, override this value.

config TUTORIAL_0013_BUTTON_ACTIVE_LOW
    bool "Button is active-low (pressed=0)"
    default y

config TUTORIAL_0013_BUTTON_DEBOUNCE_MS
    int "Debounce window (ms)"
    range 0 1000
    default 50

endmenu

menu "Tutorial 0013: GIF playback (AnimatedGIF + FATFS assets)"

config TUTORIAL_0013_GIF_MIN_FRAME_DELAY_MS
    int "Minimum frame delay (ms)"
    range 0 1000
    default 10
    help
        Some GIFs request a 0ms delay. This sets a floor so the playback loop yields.

config TUTORIAL_0013_GIF_MAX_COUNT
    int "Maximum number of GIF assets to list"
    range 1 256
    default 32
    help
        Maximum number of GIF files to read from /storage/gifs and expose via the console.

config TUTORIAL_0013_GIF_MAX_PATH_LEN
    int "Maximum GIF path length"
    range 32 256
    default 96
    help
        Maximum full path length for entries like /storage/gifs/foo.gif.

config TUTORIAL_0013_GIF_SWAP_BYTES
    bool "Byte-swap RGB565 pixels before writing into M5Canvas"
    default y
    help
        Some pipelines produce RGB565 in MSB-first byte order. Toggle this if colors look wrong.

config TUTORIAL_0013_GIF_SCALE_TO_FULL_SCREEN
    bool "Scale GIF canvas to fill 128x128 (nearest-neighbor integer scaling)"
    default y

endmenu

menu "Tutorial 0013: Debug Logging"

config TUTORIAL_0013_LOG_EVERY_N_FRAMES
    int "Log heartbeat every N frames (0=disabled)"
    range 0 10000
    default 0

endmenu
```

## 0013-atoms3r-gif-console/sdkconfig.defaults
```kconfig
# Tutorial 0013 defaults (ESP-IDF 5.4.1)
#
# Reproducible, board-appropriate defaults for AtomS3R.
#

# Flash size: AtomS3R is commonly 8MB.
CONFIG_ESPTOOLPY_FLASHSIZE_8MB=y
CONFIG_ESPTOOLPY_FLASHSIZE="8MB"

# Partition table: project-local partitions.csv (factory 4M + storage 1M).
CONFIG_PARTITION_TABLE_CUSTOM=y
CONFIG_PARTITION_TABLE_CUSTOM_FILENAME="partitions.csv"
CONFIG_PARTITION_TABLE_FILENAME="partitions.csv"

# CPU frequency: AtomS3(R) demos usually run at 240MHz.
CONFIG_ESP_DEFAULT_CPU_FREQ_MHZ_240=y
CONFIG_ESP_DEFAULT_CPU_FREQ_MHZ=240

# Main task stack: M5GFX is C++ and can be stack-hungry.
CONFIG_ESP_MAIN_TASK_STACK_SIZE=8000

# FATFS: enable long file name support so we can use real GIF filenames from the storage image.
CONFIG_FATFS_LFN_HEAP=y
CONFIG_FATFS_MAX_LFN=255

# Tutorial defaults (match known-good bring-up):
CONFIG_TUTORIAL_0013_LCD_Y_OFFSET=32
CONFIG_TUTORIAL_0013_LCD_SPI_PCLK_HZ=40000000
CONFIG_TUTORIAL_0013_CANVAS_USE_PSRAM=n
CONFIG_TUTORIAL_0013_PRESENT_USE_DMA=y
CONFIG_TUTORIAL_0013_BACKLIGHT_GATE_ENABLE=y
CONFIG_TUTORIAL_0013_BACKLIGHT_GATE_GPIO=7
CONFIG_TUTORIAL_0013_BACKLIGHT_GATE_ACTIVE_LOW=y
CONFIG_TUTORIAL_0013_BACKLIGHT_I2C_ENABLE=y
CONFIG_TUTORIAL_0013_BL_I2C_SCL_GPIO=0
CONFIG_TUTORIAL_0013_BL_I2C_SDA_GPIO=45
CONFIG_TUTORIAL_0013_BL_I2C_ADDR=0x30
CONFIG_TUTORIAL_0013_BL_I2C_REG=0x0e
CONFIG_TUTORIAL_0013_BL_BRIGHTNESS_ON=255
CONFIG_TUTORIAL_0013_BUTTON_GPIO=41
CONFIG_TUTORIAL_0013_BUTTON_ACTIVE_LOW=y
CONFIG_TUTORIAL_0013_BUTTON_DEBOUNCE_MS=50
CONFIG_ECHO_GIF_MIN_FRAME_DELAY_MS=10
CONFIG_ECHO_GIF_MAX_COUNT=32
CONFIG_ECHO_GIF_MAX_PATH_LEN=96
CONFIG_ECHO_GIF_SWAP_BYTES=y
CONFIG_ECHO_GIF_SCALE_TO_FULL_SCREEN=y
CONFIG_ECHO_GIF_STORAGE_MOUNT_PATH="/storage"
CONFIG_ECHO_GIF_STORAGE_PARTITION_LABEL="storage"
CONFIG_ECHO_GIF_STORAGE_GIF_DIR="/storage/gifs"
CONFIG_ECHO_GIF_STORAGE_GIF_DIR_FALLBACK="/storage"
CONFIG_TUTORIAL_0013_LOG_EVERY_N_FRAMES=0

# Console (default): UART on GROVE (AtomS3R Port.A, G1=GPIO1, G2=GPIO2).
#
# This sets the ESP-IDF console transport defaults so printf/ESP_LOG* and the
# esp_console REPL are on the external GROVE UART by default.
CONFIG_ESP_CONSOLE_UART_CUSTOM=y
CONFIG_ESP_CONSOLE_UART_CUSTOM_NUM_1=y
CONFIG_ESP_CONSOLE_UART_NUM=1
CONFIG_ESP_CONSOLE_UART_TX_GPIO=1
CONFIG_ESP_CONSOLE_UART_RX_GPIO=2
CONFIG_ESP_CONSOLE_UART_BAUDRATE=115200
CONFIG_ESP_CONSOLE_USB_SERIAL_JTAG=n
CONFIG_ESP_CONSOLE_UART_DEFAULT=n

# Tutorial console binding defaults (menuconfig → Tutorial 0013: Console / esp_console)
CONFIG_TUTORIAL_0013_CONSOLE_BINDING_GROVE_UART=y
CONFIG_TUTORIAL_0013_CONSOLE_UART_NUM=1
CONFIG_TUTORIAL_0013_CONSOLE_UART_BAUDRATE=115200
CONFIG_TUTORIAL_0013_CONSOLE_UART_TX_GPIO=1
CONFIG_TUTORIAL_0013_CONSOLE_UART_RX_GPIO=2
CONFIG_TUTORIAL_0013_CONSOLE_PROMPT="gif> "

# Console debug (default off; enable only when diagnosing RX wiring)
CONFIG_TUTORIAL_0013_CONSOLE_RX_HEARTBEAT_ENABLE=n
CONFIG_TUTORIAL_0013_CONSOLE_RX_HEARTBEAT_INTERVAL_MS=1000
```
